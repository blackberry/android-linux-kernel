/* Copyright (c) 2013-2015, The Linux Foundation. All rights reserved.
 *
 * This program is free software; you can redistribute it and/or modify
 * it under the terms of the GNU General Public License version 2 and
 * only version 2 as published by the Free Software Foundation.
 *
 * This program is distributed in the hope that it will be useful,
 * but WITHOUT ANY WARRANTY; without even the implied warranty of
 * MERCHANTABILITY or FITNESS FOR A PARTICULAR PURPOSE.  See the
 * GNU General Public License for more details.
 */

&mdss_mdp {
	dsi_nt35695_1080_cmd: qcom,mdss_dsi_nt35695_1080p_cmd {
		qcom,mdss-dsi-panel-name = "nt35695 1080p command mode dsi panel";
		qcom,mdss-dsi-panel-type = "dsi_cmd_mode";
		qcom,mdss-dsi-panel-framerate = <60>;
		qcom,mdss-dsi-virtual-channel-id = <0>;
		qcom,mdss-dsi-stream = <0>;
		qcom,mdss-dsi-panel-width = <1080>; 
		qcom,mdss-dsi-panel-height = <1920>;
		qcom,mdss-dsi-h-front-porch = <100>;//need to check
		qcom,mdss-dsi-h-back-porch = <100>;//need to check
		qcom,mdss-dsi-h-pulse-width = <2>;//need to check
		qcom,mdss-dsi-h-sync-skew = <0>;//need to check
		qcom,mdss-dsi-v-back-porch = <4>;//need to check
		qcom,mdss-dsi-v-front-porch = <4>;//need to check
		qcom,mdss-dsi-v-pulse-width = <2>;//need to check
		qcom,mdss-dsi-h-left-border = <0>;
		qcom,mdss-dsi-h-right-border = <0>;
		qcom,mdss-dsi-v-top-border = <0>;
		qcom,mdss-dsi-v-bottom-border = <0>;
		qcom,mdss-dsi-bpp = <24>;
		qcom,mdss-dsi-underflow-color = <0xff>;
		qcom,mdss-dsi-border-color = <0>;
		qcom,mdss-dsi-on-command = [29 01 00 00 00 00 02 FF 20
        29 01 00 00 00 00 02 00 01
        29 01 00 00 00 00 02 01 55
        29 01 00 00 00 00 02 02 45
        29 01 00 00 00 00 02 03 55
        29 01 00 00 00 00 02 05 50
        29 01 00 00 00 00 02 06 4A
        29 01 00 00 00 00 02 07 24
        29 01 00 00 00 00 02 08 0C
        29 01 00 00 00 00 02 0B 87
        29 01 00 00 00 00 02 0C 87
        29 01 00 00 00 00 02 0E B0
        29 01 00 00 00 00 02 0F AE
        29 01 00 00 00 00 02 11 1B
        29 01 00 00 00 00 02 12 10
        29 01 00 00 00 00 02 13 01
        29 01 00 00 00 00 02 14 4A
        29 01 00 00 00 00 02 15 12
        29 01 00 00 00 00 02 16 12
        29 01 00 00 00 00 02 58 82
        29 01 00 00 00 00 02 59 00
        29 01 00 00 00 00 02 5A 02
        29 01 00 00 00 00 02 5B 00
        29 01 00 00 00 00 02 5C 82
        29 01 00 00 00 00 02 5D 80
        29 01 00 00 00 00 02 5E 02
        29 01 00 00 00 00 02 5F 00
        29 01 00 00 00 00 02 30 01
        29 01 00 00 00 00 02 72 31
        29 01 00 00 00 00 02 FB 01
        29 01 00 00 00 00 02 FF 24
        29 01 00 00 00 00 02 00 01
        29 01 00 00 00 00 02 01 0B
        29 01 00 00 00 00 02 02 0C
        29 01 00 00 00 00 02 03 89
        29 01 00 00 00 00 02 04 8A
        29 01 00 00 00 00 02 05 0F
        29 01 00 00 00 00 02 06 10
        29 01 00 00 00 00 02 07 00
        29 01 00 00 00 00 02 08 1C
        29 01 00 00 00 00 02 09 00
        29 01 00 00 00 00 02 0A 00
        29 01 00 00 00 00 02 0B 00
        29 01 00 00 00 00 02 0C 00
        29 01 00 00 00 00 02 0D 13
        29 01 00 00 00 00 02 0E 15
        29 01 00 00 00 00 02 0F 17
        29 01 00 00 00 00 02 10 01
        29 01 00 00 00 00 02 11 0B
        29 01 00 00 00 00 02 12 0C
        29 01 00 00 00 00 02 13 89
        29 01 00 00 00 00 02 14 8A
        29 01 00 00 00 00 02 15 0F
        29 01 00 00 00 00 02 16 10
        29 01 00 00 00 00 02 17 10
        29 01 00 00 00 00 02 18 1C
        29 01 00 00 00 00 02 19 00
        29 01 00 00 00 00 02 1A 00
        29 01 00 00 00 00 02 1B 00
        29 01 00 00 00 00 02 1C 00
        29 01 00 00 00 00 02 1D 13
        29 01 00 00 00 00 02 1E 15
        29 01 00 00 00 00 02 1F 17
        29 01 00 00 00 00 02 20 00
        29 01 00 00 00 00 02 21 01
        29 01 00 00 00 00 02 22 00
        29 01 00 00 00 00 02 23 40
        29 01 00 00 00 00 02 24 40
        29 01 00 00 00 00 02 25 6D
        29 01 00 00 00 00 02 26 40
        29 01 00 00 00 00 02 27 40
        29 01 00 00 00 00 02 BD 20
        29 01 00 00 00 00 02 B6 21
        29 01 00 00 00 00 02 B7 22
        29 01 00 00 00 00 02 B8 07
        29 01 00 00 00 00 02 B9 07
        29 01 00 00 00 00 02 C1 6D
        29 01 00 00 00 00 02 BE 07
        29 01 00 00 00 00 02 BF 07
        29 01 00 00 00 00 02 29 D8
        29 01 00 00 00 00 02 2A 2A
        29 01 00 00 00 00 02 4B 03
        29 01 00 00 00 00 02 4C 11
        29 01 00 00 00 00 02 4D 10
        29 01 00 00 00 00 02 4E 01
        29 01 00 00 00 00 02 4F 01
        29 01 00 00 00 00 02 50 10
        29 01 00 00 00 00 02 51 00
        29 01 00 00 00 00 02 52 80
        29 01 00 00 00 00 02 53 00
        29 01 00 00 00 00 02 56 00
        29 01 00 00 00 00 02 54 07
        29 01 00 00 00 00 02 58 07
        29 01 00 00 00 00 02 55 25
        29 01 00 00 00 00 02 5B 43
        29 01 00 00 00 00 02 5C 00
        29 01 00 00 00 00 02 5F 73
        29 01 00 00 00 00 02 60 73
        29 01 00 00 00 00 02 63 22
        29 01 00 00 00 00 02 64 00
        29 01 00 00 00 00 02 67 08
        29 01 00 00 00 00 02 68 04
        29 01 00 00 00 00 02 7A 80
        29 01 00 00 00 00 02 7B 91
        29 01 00 00 00 00 02 7C D8
        29 01 00 00 00 00 02 7D 60
        29 01 00 00 00 00 02 93 12
        29 01 00 00 00 00 02 94 06
        29 01 00 00 00 00 02 B3 C0
        29 01 00 00 00 00 02 B4 00
        29 01 00 00 00 00 02 B5 00
        29 01 00 00 00 00 02 8A 00
        29 01 00 00 00 00 02 9B 0F
        29 01 00 00 00 00 02 E3 00
        29 01 00 00 00 00 02 FB 01
        29 01 00 00 00 00 02 EC 00				
        29 01 00 00 00 00 02 FF 20
        29 01 00 00 00 00 02 FB 01
        29 01 00 00 00 00 02 75 00
        29 01 00 00 00 00 02 76 30
        29 01 00 00 00 00 02 77 00
        29 01 00 00 00 00 02 78 49
        29 01 00 00 00 00 02 79 00
        29 01 00 00 00 00 02 7A 71
        29 01 00 00 00 00 02 7B 00
        29 01 00 00 00 00 02 7C 8A
        29 01 00 00 00 00 02 7D 00
        29 01 00 00 00 00 02 7E A4
        29 01 00 00 00 00 02 7F 00
        29 01 00 00 00 00 02 80 B8
        29 01 00 00 00 00 02 81 00
        29 01 00 00 00 00 02 82 C9
        29 01 00 00 00 00 02 83 00
        29 01 00 00 00 00 02 84 D7
        29 01 00 00 00 00 02 85 00
        29 01 00 00 00 00 02 86 E5
        29 01 00 00 00 00 02 87 01
        29 01 00 00 00 00 02 88 13
        29 01 00 00 00 00 02 89 01
        29 01 00 00 00 00 02 8A 38
        29 01 00 00 00 00 02 8B 01
        29 01 00 00 00 00 02 8C 73
        29 01 00 00 00 00 02 8D 01
        29 01 00 00 00 00 02 8E A0
        29 01 00 00 00 00 02 8F 01
        29 01 00 00 00 00 02 90 E7
        29 01 00 00 00 00 02 91 02
        29 01 00 00 00 00 02 92 20
        29 01 00 00 00 00 02 93 02
        29 01 00 00 00 00 02 94 21
        29 01 00 00 00 00 02 95 02
        29 01 00 00 00 00 02 96 54
        29 01 00 00 00 00 02 97 02
        29 01 00 00 00 00 02 98 8C
        29 01 00 00 00 00 02 99 02
        29 01 00 00 00 00 02 9A B1
        29 01 00 00 00 00 02 9B 02
        29 01 00 00 00 00 02 9C E3
        29 01 00 00 00 00 02 9D 03
        29 01 00 00 00 00 02 9E 05
        29 01 00 00 00 00 02 9F 03
        29 01 00 00 00 00 02 A0 32
        29 01 00 00 00 00 02 A2 03
        29 01 00 00 00 00 02 A3 3F
        29 01 00 00 00 00 02 A4 03
        29 01 00 00 00 00 02 A5 4E
        29 01 00 00 00 00 02 A6 03
        29 01 00 00 00 00 02 A7 5F
        29 01 00 00 00 00 02 A9 03
        29 01 00 00 00 00 02 AA 71
        29 01 00 00 00 00 02 AB 03
        29 01 00 00 00 00 02 AC 83
        29 01 00 00 00 00 02 AD 03
        29 01 00 00 00 00 02 AE 9A
        29 01 00 00 00 00 02 AF 03
        29 01 00 00 00 00 02 B0 A4
        29 01 00 00 00 00 02 B1 03
        29 01 00 00 00 00 02 B2 CB
        29 01 00 00 00 00 02 B3 00
        29 01 00 00 00 00 02 B4 30
        29 01 00 00 00 00 02 B5 00
        29 01 00 00 00 00 02 B6 49
        29 01 00 00 00 00 02 B7 00
        29 01 00 00 00 00 02 B8 71
        29 01 00 00 00 00 02 B9 00
        29 01 00 00 00 00 02 BA 8A
        29 01 00 00 00 00 02 BB 00
        29 01 00 00 00 00 02 BC A4
        29 01 00 00 00 00 02 BD 00
        29 01 00 00 00 00 02 BE B8
        29 01 00 00 00 00 02 BF 00
        29 01 00 00 00 00 02 C0 C9
        29 01 00 00 00 00 02 C1 00
        29 01 00 00 00 00 02 C2 D7
        29 01 00 00 00 00 02 C3 00
        29 01 00 00 00 00 02 C4 E5
        29 01 00 00 00 00 02 C5 01
        29 01 00 00 00 00 02 C6 13
        29 01 00 00 00 00 02 C7 01
        29 01 00 00 00 00 02 C8 38
        29 01 00 00 00 00 02 C9 01
        29 01 00 00 00 00 02 CA 73
        29 01 00 00 00 00 02 CB 01
        29 01 00 00 00 00 02 CC A0
        29 01 00 00 00 00 02 CD 01
        29 01 00 00 00 00 02 CE E7
        29 01 00 00 00 00 02 CF 02
        29 01 00 00 00 00 02 D0 20
        29 01 00 00 00 00 02 D1 02
        29 01 00 00 00 00 02 D2 21
        29 01 00 00 00 00 02 D3 02
        29 01 00 00 00 00 02 D4 54
        29 01 00 00 00 00 02 D5 02
        29 01 00 00 00 00 02 D6 8C
        29 01 00 00 00 00 02 D7 02
        29 01 00 00 00 00 02 D8 B1
        29 01 00 00 00 00 02 D9 02
        29 01 00 00 00 00 02 DA E3
        29 01 00 00 00 00 02 DB 03
        29 01 00 00 00 00 02 DC 05
        29 01 00 00 00 00 02 DD 03
        29 01 00 00 00 00 02 DE 32
        29 01 00 00 00 00 02 DF 03
        29 01 00 00 00 00 02 E0 3F
        29 01 00 00 00 00 02 E1 03
        29 01 00 00 00 00 02 E2 4E
        29 01 00 00 00 00 02 E3 03
        29 01 00 00 00 00 02 E4 5F
        29 01 00 00 00 00 02 E5 03
        29 01 00 00 00 00 02 E6 71
        29 01 00 00 00 00 02 E7 03
        29 01 00 00 00 00 02 E8 83
        29 01 00 00 00 00 02 E9 03
        29 01 00 00 00 00 02 EA 9A
        29 01 00 00 00 00 02 EB 03
        29 01 00 00 00 00 02 EC A4
        29 01 00 00 00 00 02 ED 03
        29 01 00 00 00 00 02 EE CB
        29 01 00 00 00 00 02 EF 00
        29 01 00 00 00 00 02 F0 30
        29 01 00 00 00 00 02 F1 00
        29 01 00 00 00 00 02 F2 49
        29 01 00 00 00 00 02 F3 00
        29 01 00 00 00 00 02 F4 71
        29 01 00 00 00 00 02 F5 00
        29 01 00 00 00 00 02 F6 8A
        29 01 00 00 00 00 02 F7 00
        29 01 00 00 00 00 02 F8 A4
        29 01 00 00 00 00 02 F9 00
        29 01 00 00 00 00 02 FA B8
        29 01 00 00 00 00 02 FF 21
        29 01 00 00 00 00 02 FB 01
        29 01 00 00 00 00 02 00 00
        29 01 00 00 00 00 02 01 C9
        29 01 00 00 00 00 02 02 00
        29 01 00 00 00 00 02 03 D7
        29 01 00 00 00 00 02 04 00
        29 01 00 00 00 00 02 05 E5
        29 01 00 00 00 00 02 06 01
        29 01 00 00 00 00 02 07 13
        29 01 00 00 00 00 02 08 01
        29 01 00 00 00 00 02 09 38
        29 01 00 00 00 00 02 0A 01
        29 01 00 00 00 00 02 0B 73
        29 01 00 00 00 00 02 0C 01
        29 01 00 00 00 00 02 0D A0
        29 01 00 00 00 00 02 0E 01
        29 01 00 00 00 00 02 0F E7
        29 01 00 00 00 00 02 10 02
        29 01 00 00 00 00 02 11 20
        29 01 00 00 00 00 02 12 02
        29 01 00 00 00 00 02 13 21
        29 01 00 00 00 00 02 14 02
        29 01 00 00 00 00 02 15 54
        29 01 00 00 00 00 02 16 02
        29 01 00 00 00 00 02 17 8C
        29 01 00 00 00 00 02 18 02
        29 01 00 00 00 00 02 19 B1
        29 01 00 00 00 00 02 1A 02
        29 01 00 00 00 00 02 1B E3
        29 01 00 00 00 00 02 1C 03
        29 01 00 00 00 00 02 1D 05
        29 01 00 00 00 00 02 1E 03
        29 01 00 00 00 00 02 1F 32
        29 01 00 00 00 00 02 20 03
        29 01 00 00 00 00 02 21 3F
        29 01 00 00 00 00 02 22 03
        29 01 00 00 00 00 02 23 4E
        29 01 00 00 00 00 02 24 03
        29 01 00 00 00 00 02 25 5F
        29 01 00 00 00 00 02 26 03
        29 01 00 00 00 00 02 27 71
        29 01 00 00 00 00 02 28 03
        29 01 00 00 00 00 02 29 83
        29 01 00 00 00 00 02 2A 03
        29 01 00 00 00 00 02 2B 9A
        29 01 00 00 00 00 02 2D 03
        29 01 00 00 00 00 02 2F A4
        29 01 00 00 00 00 02 30 03
        29 01 00 00 00 00 02 31 CB
        29 01 00 00 00 00 02 32 00
        29 01 00 00 00 00 02 33 30
        29 01 00 00 00 00 02 34 00
        29 01 00 00 00 00 02 35 49
        29 01 00 00 00 00 02 36 00
        29 01 00 00 00 00 02 37 71
        29 01 00 00 00 00 02 38 00
        29 01 00 00 00 00 02 39 8A
        29 01 00 00 00 00 02 3A 00
        29 01 00 00 00 00 02 3B A4
        29 01 00 00 00 00 02 3D 00
        29 01 00 00 00 00 02 3F B8
        29 01 00 00 00 00 02 40 00
        29 01 00 00 00 00 02 41 C9
        29 01 00 00 00 00 02 42 00
        29 01 00 00 00 00 02 43 D7
        29 01 00 00 00 00 02 44 00
        29 01 00 00 00 00 02 45 E5
        29 01 00 00 00 00 02 46 01
        29 01 00 00 00 00 02 47 13
        29 01 00 00 00 00 02 48 01
        29 01 00 00 00 00 02 49 38
        29 01 00 00 00 00 02 4A 01
        29 01 00 00 00 00 02 4B 73
        29 01 00 00 00 00 02 4C 01
        29 01 00 00 00 00 02 4D A0
        29 01 00 00 00 00 02 4E 01
        29 01 00 00 00 00 02 4F E7
        29 01 00 00 00 00 02 50 02
        29 01 00 00 00 00 02 51 20
        29 01 00 00 00 00 02 52 02
        29 01 00 00 00 00 02 53 21
        29 01 00 00 00 00 02 54 02
        29 01 00 00 00 00 02 55 54
        29 01 00 00 00 00 02 56 02
        29 01 00 00 00 00 02 58 8C
        29 01 00 00 00 00 02 59 02
        29 01 00 00 00 00 02 5A B1
        29 01 00 00 00 00 02 5B 02
        29 01 00 00 00 00 02 5C E3
        29 01 00 00 00 00 02 5D 03
        29 01 00 00 00 00 02 5E 05
        29 01 00 00 00 00 02 5F 03
        29 01 00 00 00 00 02 60 32
        29 01 00 00 00 00 02 61 03
        29 01 00 00 00 00 02 62 3F
        29 01 00 00 00 00 02 63 03
        29 01 00 00 00 00 02 64 4E
        29 01 00 00 00 00 02 65 03
        29 01 00 00 00 00 02 66 5F
        29 01 00 00 00 00 02 67 03
        29 01 00 00 00 00 02 68 71
        29 01 00 00 00 00 02 69 03
        29 01 00 00 00 00 02 6A 83
        29 01 00 00 00 00 02 6B 03
        29 01 00 00 00 00 02 6C 9A
        29 01 00 00 00 00 02 6D 03
        29 01 00 00 00 00 02 6E A4
        29 01 00 00 00 00 02 6F 03
        29 01 00 00 00 00 02 70 CB
        29 01 00 00 00 00 02 71 00
        29 01 00 00 00 00 02 72 30
        29 01 00 00 00 00 02 73 00
        29 01 00 00 00 00 02 74 49
        29 01 00 00 00 00 02 75 00
        29 01 00 00 00 00 02 76 71
        29 01 00 00 00 00 02 77 00
        29 01 00 00 00 00 02 78 8A
        29 01 00 00 00 00 02 79 00
        29 01 00 00 00 00 02 7A A4
        29 01 00 00 00 00 02 7B 00
        29 01 00 00 00 00 02 7C B8
        29 01 00 00 00 00 02 7D 00
        29 01 00 00 00 00 02 7E C9
        29 01 00 00 00 00 02 7F 00
        29 01 00 00 00 00 02 80 D7
        29 01 00 00 00 00 02 81 00
        29 01 00 00 00 00 02 82 E5
        29 01 00 00 00 00 02 83 01
        29 01 00 00 00 00 02 84 13
        29 01 00 00 00 00 02 85 01
        29 01 00 00 00 00 02 86 38
        29 01 00 00 00 00 02 87 01
        29 01 00 00 00 00 02 88 73
        29 01 00 00 00 00 02 89 01
        29 01 00 00 00 00 02 8A A0
        29 01 00 00 00 00 02 8B 01
        29 01 00 00 00 00 02 8C E7
        29 01 00 00 00 00 02 8D 02
        29 01 00 00 00 00 02 8E 20
        29 01 00 00 00 00 02 8F 02
        29 01 00 00 00 00 02 90 21
        29 01 00 00 00 00 02 91 02
        29 01 00 00 00 00 02 92 54
        29 01 00 00 00 00 02 93 02
        29 01 00 00 00 00 02 94 8C
        29 01 00 00 00 00 02 95 02
        29 01 00 00 00 00 02 96 B1
        29 01 00 00 00 00 02 97 02
        29 01 00 00 00 00 02 98 E3
        29 01 00 00 00 00 02 99 03
        29 01 00 00 00 00 02 9A 05
        29 01 00 00 00 00 02 9B 03
        29 01 00 00 00 00 02 9C 32
        29 01 00 00 00 00 02 9D 03
        29 01 00 00 00 00 02 9E 3F
        29 01 00 00 00 00 02 9F 03
        29 01 00 00 00 00 02 A0 4E
        29 01 00 00 00 00 02 A2 03
        29 01 00 00 00 00 02 A3 5F
        29 01 00 00 00 00 02 A4 03
        29 01 00 00 00 00 02 A5 71
        29 01 00 00 00 00 02 A6 03
        29 01 00 00 00 00 02 A7 83
        29 01 00 00 00 00 02 A9 03
        29 01 00 00 00 00 02 AA 9A
        29 01 00 00 00 00 02 AB 03
        29 01 00 00 00 00 02 AC A4
        29 01 00 00 00 00 02 AD 03
        29 01 00 00 00 00 02 AE CB
        29 01 00 00 00 00 02 AF 00
        29 01 00 00 00 00 02 B0 30
        29 01 00 00 00 00 02 B1 00
        29 01 00 00 00 00 02 B2 49
        29 01 00 00 00 00 02 B3 00
        29 01 00 00 00 00 02 B4 71
        29 01 00 00 00 00 02 B5 00
        29 01 00 00 00 00 02 B6 8A
        29 01 00 00 00 00 02 B7 00
        29 01 00 00 00 00 02 B8 A4
        29 01 00 00 00 00 02 B9 00
        29 01 00 00 00 00 02 BA B8
        29 01 00 00 00 00 02 BB 00
        29 01 00 00 00 00 02 BC C9
        29 01 00 00 00 00 02 BD 00
        29 01 00 00 00 00 02 BE D7
        29 01 00 00 00 00 02 BF 00
        29 01 00 00 00 00 02 C0 E5
        29 01 00 00 00 00 02 C1 01
        29 01 00 00 00 00 02 C2 13
        29 01 00 00 00 00 02 C3 01
        29 01 00 00 00 00 02 C4 38
        29 01 00 00 00 00 02 C5 01
        29 01 00 00 00 00 02 C6 73
        29 01 00 00 00 00 02 C7 01
        29 01 00 00 00 00 02 C8 A0
        29 01 00 00 00 00 02 C9 01
        29 01 00 00 00 00 02 CA E7
        29 01 00 00 00 00 02 CB 02
        29 01 00 00 00 00 02 CC 20
        29 01 00 00 00 00 02 CD 02
        29 01 00 00 00 00 02 CE 21
        29 01 00 00 00 00 02 CF 02
        29 01 00 00 00 00 02 D0 54
        29 01 00 00 00 00 02 D1 02
        29 01 00 00 00 00 02 D2 8C
        29 01 00 00 00 00 02 D3 02
        29 01 00 00 00 00 02 D4 B1
        29 01 00 00 00 00 02 D5 02
        29 01 00 00 00 00 02 D6 E3
        29 01 00 00 00 00 02 D7 03
        29 01 00 00 00 00 02 D8 05
        29 01 00 00 00 00 02 D9 03
        29 01 00 00 00 00 02 DA 32
        29 01 00 00 00 00 02 DB 03
        29 01 00 00 00 00 02 DC 3F
        29 01 00 00 00 00 02 DD 03
        29 01 00 00 00 00 02 DE 4E
        29 01 00 00 00 00 02 DF 03
        29 01 00 00 00 00 02 E0 5F
        29 01 00 00 00 00 02 E1 03
        29 01 00 00 00 00 02 E2 71
        29 01 00 00 00 00 02 E3 03
        29 01 00 00 00 00 02 E4 83
        29 01 00 00 00 00 02 E5 03
        29 01 00 00 00 00 02 E6 9A
        29 01 00 00 00 00 02 E7 03
        29 01 00 00 00 00 02 E8 A4
        29 01 00 00 00 00 02 E9 03
        29 01 00 00 00 00 02 EA CB
        29 01 00 00 00 00 02 FF 10
        29 01 00 00 00 00 04 3B 03 06 06
        29 01 00 00 00 00 02 35 00
        29 01 00 00 00 00 03 44 03 00
        29 01 00 00 00 00 02 BB 10
        29 01 00 00 96 00 02 11 00
        29 01 00 00 64 00 02 29 00];
		qcom,mdss-dsi-off-command = [05 01 00 00 32 00 02 28 00
					05 01 00 00 78 00 02 10 00];
		qcom,mdss-dsi-on-command-state = "dsi_lp_mode";
		qcom,mdss-dsi-off-command-state = "dsi_hs_mode";
		qcom,mdss-dsi-panel-status-check-mode = "bta_check";
		qcom,mdss-dsi-h-sync-pulse = <1>;
		qcom,mdss-dsi-traffic-mode = "burst_mode";
		qcom,mdss-dsi-bllp-eof-power-mode;
		qcom,mdss-dsi-bllp-power-mode;
		qcom,mdss-dsi-lane-0-state;
		qcom,mdss-dsi-lane-1-state;
		qcom,mdss-dsi-lane-2-state;
		qcom,mdss-dsi-lane-3-state;
		qcom,mdss-dsi-te-pin-select = <1>;
		qcom,mdss-dsi-wr-mem-start = <0x2c>;
		qcom,mdss-dsi-te-dcs-command = <1>;
		qcom,mdss-dsi-te-check-enable;
		qcom,mdss-dsi-te-using-te-pin;
		qcom,mdss-dsi-panel-timings = [E6 38 26 00 68 6C 2A 3A 2C 03 04 00]; //need to check
		qcom,mdss-dsi-t-clk-post = <0x28>;//need to check
		qcom,mdss-dsi-t-clk-pre = <0x2B>;//need to check
		qcom,mdss-dsi-bl-min-level = <1>;
		qcom,mdss-dsi-bl-max-level = <4095>;
		qcom,mdss-dsi-dma-trigger = "trigger_sw";
		qcom,mdss-dsi-mdp-trigger = "none";
		qcom,mdss-dsi-bl-pmic-control-type = "bl_ctrl_wled";
		qcom,mdss-dsi-reset-sequence = <1 20>, <0 20>, <1 20>;//need to check
		/* TCT-SH jhyu fix 1018249_add lcd physical width and height 12-17-2015 */
		qcom,mdss-pan-physical-width-dimension = <65>;
		qcom,mdss-pan-physical-height-dimension = <115>;
		//qcom,partial-update-enabled;
		//qcom,panel-roi-alignment = <2 2 2 2 0 0>;//need to check
	};
};
