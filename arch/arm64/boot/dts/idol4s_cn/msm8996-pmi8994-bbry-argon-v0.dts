/* Copyright (C) 2016 BlackBerry Limited. All rights reserved.
 * Copyright (c) 2015, The Linux Foundation. All rights reserved.
 *
 * This program is free software; you can redistribute it and/or modify
 * it under the terms of the GNU General Public License version 2 and
 * only version 2 as published by the Free Software Foundation.
 *
 * This program is distributed in the hope that it will be useful,
 * but WITHOUT ANY WARRANTY; without even the implied warranty of
 * MERCHANTABILITY or FITNESS FOR A PARTICULAR PURPOSE.  See the
 * GNU General Public License for more details.
 */


/dts-v1/;

#include "msm8996-v3.dtsi"
#include "msm8996-mtp.dtsi"
#include "msm8996-bbry-argon.dtsi"

/ {
	model = "MSM 8996 ARGON V0 PMI8994";
	qcom,board-id = <0xF062912A 0x00010200>; /* R--- Special proto with pmi8994  */

	hwfeatures_node {
		mechanical {
			rev = "M1";
		};
	};

};

