/* Copyright (C) 2016 BlackBerry Limited. All rights reserved.
 * Copyright (c) 2015, The Linux Foundation. All rights reserved.
 *
 * This program is free software; you can redistribute it and/or modify
 * it under the terms of the GNU General Public License version 2 and
 * only version 2 as published by the Free Software Foundation.
 *
 * This program is distributed in the hope that it will be useful,
 * but WITHOUT ANY WARRANTY; without even the implied warranty of
 * MERCHANTABILITY or FITNESS FOR A PARTICULAR PURPOSE.  See the
 * GNU General Public License for more details.
 */

/dts-v1/;

#include "msm8952-mtp.dtsi"
#include "msm8952-bbry-hamburg.dtsi"

/ {
	model = "MSM 8952 HAMBURG V0";
	qcom,board-id = <0xF21FF22A 0x00010100>,
            <0xF21FF206 0x00010100>,
            <0xF21FF281 0x00010100>;

	hwfeatures {
		mechanical {
			rev = "M1";
		};
	};

};

