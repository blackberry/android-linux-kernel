/* Copyright (C) 2015 BlackBerry Limited. All rights reserved.
 * Copyright (c) 2014-2015, The Linux Foundation. All rights reserved.
 *
 * This program is free software; you can redistribute it and/or modify
 * it under the terms of the GNU General Public License version 2 and
 * only version 2 as published by the Free Software Foundation.
 *
 * This program is distributed in the hope that it will be useful,
 * but WITHOUT ANY WARRANTY; without even the implied warranty of
 * MERCHANTABILITY or FITNESS FOR A PARTICULAR PURPOSE.  See the
 * GNU General Public License for more details.
 */

qcom,havana-atl {
	/* #1921030_RIM_Venice_3360mAh_averaged_MasterSlave_May14th2015*/
	qcom,max-voltage-uv = <4400000>;
	qcom,nom-batt-capacity-mah = <3360>;
	qcom,batt-id-kohm = <39 56 10 23>;
	qcom,battery-beta = <3400>;
	qcom,battery-type = "havana_atl_May14th2015";
	qcom,chg-rslow-comp-c1 = <2842414>;
	qcom,chg-rslow-comp-c2 = <3300139>;
	qcom,chg-rs-to-rslow = <1033177>;
	qcom,chg-rslow-comp-thr = <0x99>;
	qcom,checksum = <0xCC8E>;
	qcom,gui-version = "PMI8994GUI - 2.1.6.5";
	qcom,fg-profile-data = [
		 F2 83 5B 7D 
		 51 81 7B 77 
		 5A 83 24 64 
		 39 82 34 8D 
		 2A 82 55 9A 
		 AC BD EF CA 
		 5C 0E EF 83 
		 D5 7C D8 80 
		 7B 76 5D 83 
		 6D 50 57 82 
		 9E 8E 5C 82 
		 79 99 C5 BC 
		 9B C9 52 0D 
		 4E 0D 33 5A 
		 14 70 B3 FB 
		 6A 45 52 3E 
		 43 40 00 00 
		 B0 45 91 2B 
		 3E 25 00 00 
		 00 00 00 00 
		 00 00 00 00 
		 0B 70 FC 6A 
		 20 4B C7 7B 
		 73 74 DF 5B 
		 43 59 B1 7B 
		 C8 6F 31 5A 
		 D6 88 1C D0 
		 09 F4 5B A6 
		 5D A0 71 0C 
		 28 00 FF 36 
		 F0 11 30 03 
		 00 00 00 0C 
	];
};
