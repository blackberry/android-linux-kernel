/* Copyright (c) 2015, The Linux Foundation. All rights reserved.
 *
 * This program is free software; you can redistribute it and/or modify
 * it under the terms of the GNU General Public License version 2 and
 * only version 2 as published by the Free Software Foundation.
 *
 * This program is distributed in the hope that it will be useful,
 * but WITHOUT ANY WARRANTY; without even the implied warranty of
 * MERCHANTABILITY or FITNESS FOR A PARTICULAR PURPOSE.  See the
 * GNU General Public License for more details.
 */

/*---------------------------------------------------------------------------
 * This file is autogenerated file using gcdb parser. Please do not edit it.
 * Update input XML file to add a new entry or update variable in this file
 * VERSION = "1.0"
 *---------------------------------------------------------------------------*/
&mdss_mdp {
	dsi_livata_video: qcom,mdss_dsi_livata_video {
		qcom,mdss-dsi-panel-name = "Livata video mode dsi panel";
		qcom,mdss-dsi-panel-type = "dsi_video_mode";
		qcom,mdss-dsi-panel-framerate = <60>;
		qcom,mdss-dsi-virtual-channel-id = <0>;
		qcom,mdss-dsi-stream = <0>;
		qcom,mdss-dsi-panel-width = <1080>;
		qcom,mdss-dsi-panel-height = <1620>;  /* change to 1920 for BOE standard panel */
		qcom,mdss-pan-physical-width-dimension = <63>;  /* 435 px/inch = (1080 px / 63mm) * 25.4 mm/inch  */
		qcom,mdss-pan-physical-height-dimension = <95>; /* 435 px/inch = (1620 px / 95mm) * 25.4 mm/inch  */
		qcom,mdss-dsi-h-front-porch = <10>; //modified by bb
		qcom,mdss-dsi-h-back-porch = <10>; //modified by bb
		qcom,mdss-dsi-h-pulse-width = <4>; //modified by bb
		qcom,mdss-dsi-h-sync-skew = <0>;
		qcom,mdss-dsi-v-back-porch = <14>; //modified by bb
		qcom,mdss-dsi-v-front-porch = <400>; //modified by bb
		qcom,mdss-dsi-v-pulse-width = <1>; //modified by bb
		qcom,mdss-dsi-h-left-border = <0>;
		qcom,mdss-dsi-h-right-border = <0>;
		qcom,mdss-dsi-v-top-border = <0>;
		qcom,mdss-dsi-v-bottom-border = <0>;
		qcom,mdss-dsi-bpp = <24>;
		qcom,mdss-dsi-underflow-color = <0xff>;
		qcom,mdss-dsi-border-color = <0>;
		qcom,mdss-dsi-on-command = [
/* add by bb begin */
			29 01 00 00 01 00 02 00 00
			29 01 00 00 01 00 04 ff 87 07 01
			29 01 00 00 01 00 02 00 80
			29 01 00 00 01 00 03 ff 87 07
			29 01 00 00 01 00 02 00 a3
			29 01 00 00 01 00 05 b3 06 54 00 10
			29 01 00 00 01 00 02 00 b4
			29 01 00 00 01 00 02 c0 00
/* add by bb end */
/* ce code */
			29 01 00 00 00 00 02 00 A0
			29 01 00 00 00 00 0D D6 0c 0a 08 09 0f 0f 14 15 10 1b 16 12
			29 01 00 00 00 00 02 00 B0
			29 01 00 00 00 00 0D D6 c5 80 88 78 7d 7a 7b 76 94 97 b2 dd
			29 01 00 00 00 00 02 00 C0
			29 01 00 00 00 00 0D D6 84 80 8a 7d 81 80 9c 8f 93 a0 9a 99
			29 01 00 00 00 00 02 00 D0
			29 01 00 00 00 00 0D D6 9a 8a 8d 9a 80 80 98 9b aa aa a6 94
			29 01 00 00 00 00 02 00 00
			29 01 00 00 00 00 02 91 80
/* ce code end */
/* gamma code */
			29 01 00 00 00 00 02 00 00
			29 01 00 00 00 00 10 E1 00 05 12 22 2b 3b 4a 58 58 65 65 77 90 7d 7f
			29 01 00 00 00 00 02 00 10
			29 01 00 00 00 00 0A E1 74 6d 60 4e 3f 33 25 09 00
			29 01 00 00 00 00 02 00 00
			29 01 00 00 00 00 10 E2 00 05 12 22 2b 3b 4a 58 58 65 65 77 90 7d 7f
			29 01 00 00 00 00 02 00 10
			29 01 00 00 00 00 0A E2 74 6d 60 4e 3f 33 25 09 00
/* gamma code end */
			29 01 00 00 01 00 02 00 00
			29 01 00 00 01 00 04 ff 00 00 00
			29 01 00 00 01 00 02 00 80
			29 01 00 00 01 00 03 ff 00 00
/* start:BBRY_ANDROID */
/* Sleep out, Glass On delays reduced. */
			05 01 00 00 78 00 02 11 00	/*Mod by LCY,delay 120ms when sleep out,defect-3704076, 2016/12/12*/
			05 01 00 00 22 00 02 29 00
/* end:BBRY_ANDROID */
			];
		qcom,mdss-dsi-off-command = [
/* start:BBRY_ANDROID */
/* Glass off, Sleep in delays reduced. */
			05 01 00 00 22 00 02 28 00
			05 01 00 00 78 00 02 10 00
/* end:BBRY_ANDROID */
			];
		qcom,mdss-dsi-on-command-state = "dsi_lp_mode";
		qcom,mdss-dsi-off-command-state = "dsi_lp_mode"; // MODIFIED by Haojun Chen, 2016-11-24,BUG-3418596
		qcom,mdss-dsi-h-sync-pulse = <1>;
		qcom,mdss-dsi-traffic-mode = "burst_mode";
		qcom,mdss-dsi-bllp-eof-power-mode;
		qcom,mdss-dsi-bllp-power-mode;
		qcom,mdss-dsi-lane-0-state;
		qcom,mdss-dsi-lane-1-state;
		qcom,mdss-dsi-lane-2-state;
		qcom,mdss-dsi-lane-3-state;
		qcom,mdss-dsi-panel-timings = [7d 25 1d 00 37 33
			22 27 1e 03 04 00];
		qcom,mdss-dsi-t-clk-post = <0x20>;
		qcom,mdss-dsi-t-clk-pre = <0x34>;	/*Mod by LCY,defect-3786100,modify lcd mipi timing,2016/12/19*/
		qcom,mdss-dsi-bl-min-level = <1>;
		qcom,mdss-dsi-bl-max-level = <4095>;
		qcom,mdss-dsi-dma-trigger = "trigger_sw";
		qcom,mdss-dsi-mdp-trigger = "none";
		qcom,mdss-dsi-bl-pmic-control-type = "bl_ctrl_wled";
		qcom,mdss-dsi-reset-sequence = <1 20>, <0 2>, <1 20>;
		qcom,esd-check-enabled;
		qcom,mdss-dsi-panel-status-command = [
			06 01 00 01 05 00 01 0A
			06 01 00 01 05 00 01 0D
			06 01 00 01 05 00 01 AC
		];
		qcom,mdss-dsi-panel-status-command-mode = "dsi_lp_mode";
		qcom,mdss-dsi-panel-status-check-mode = "reg_read";
		qcom,mdss-dsi-panel-status-read-length = <1 1 1>;
		qcom,mdss-dsi-panel-status-value = <0x9c 0x00 0x00>;
		qcom,mdss-dsi-panel-max-error-count = <3>;
	};
};
