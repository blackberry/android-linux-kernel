/* Copyright (C) 2016 BlackBerry Limited. All rights reserved.
 * Copyright (c) 2014, The Linux Foundation. All rights reserved.
 *
 * This program is free software; you can redistribute it and/or modify
 * it under the terms of the GNU General Public License version 2 and
 * only version 2 as published by the Free Software Foundation.
 *
 * This program is distributed in the hope that it will be useful,
 * but WITHOUT ANY WARRANTY; without even the implied warranty of
 * MERCHANTABILITY or FITNESS FOR A PARTICULAR PURPOSE.  See the
 * GNU General Public License for more details.
 */
#include "dsi-panel-livata-video.dtsi"



/* MODIFIED-BEGIN by hongwei.tian, 2016-07-29,BUG-2635028*/
&pmi_haptic{
	qcom,actuator-type = "erm";
	qcom,wave-play-rate-us = <5263>;
	qcom,vmax-mv = <2700>; // MODIFIED by hongwei.tian, 2016-08-16,BUG-2635028
};
/* MODIFIED-END by hongwei.tian,BUG-2635028*/

&dsi_livata_video {
	qcom,panel-supply-entries = <&dsi_panel_pwr_supply>;
	qcom,mdss-dsi-panel-timings-8996 = [24 1f 08 09 05 03 04 a0
		24 1f 08 09 05 03 04 a0
		24 1f 08 09 05 03 04 a0
		24 1f 08 09 05 03 04 a0
		24 1b 08 09 05 03 04 a0];
};

&mdss_dsi0 {
       /* This is the TP_RST_N touch reset line which is required for the display to turn on. */
       qcom,platform-bklight-en-gpio = <&tlmm 64 0>;
};
