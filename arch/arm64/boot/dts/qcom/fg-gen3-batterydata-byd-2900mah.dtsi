/* Copyright (C) 2018 Tcl Corporation Limited */
/* Copyright (c) 2016-2017, The Linux Foundation. All rights reserved.
 *
 * This program is free software; you can redistribute it and/or modify
 * it under the terms of the GNU General Public License version 2 and
 * only version 2 as published by the Free Software Foundation.
 *
 * This program is distributed in the hope that it will be useful,
 * but WITHOUT ANY WARRANTY; without even the implied warranty of
 * MERCHANTABILITY or FITNESS FOR A PARTICULAR PURPOSE.  See the
 * GNU General Public License for more details.
 */

qcom,tlp029c1byd_2900mah {
	/* #2648359_TCL_TLP029C1byd_3000mAh_averaged_MasterSlave_Feb26th2018*/
	qcom,default-battery-type;
	qcom,max-voltage-uv = <4402500>;
	qcom,nom-batt-capacity-mah = <2900>;
	qcom,fg-cc-cv-threshold-mv = <4390>;
	qcom,fastchg-current-ma = <2900>;
	qcom,batt-id-kohm = <33>;
	qcom,battery-beta = <3435>;
	qcom,battery-type = "byd-2900mah";
	qcom,checksum = <0x3C24>;
	qcom,gui-version = "PM660GUI - 0.0.0.45";
	qcom,fg-profile-data = [
		 45 1F EF 05
		 35 0A 2F FD
		 E3 1C D7 01
		 EF 0D 6A 0A
		 52 17 16 2A
		 0F 44 8B 5A
		 75 00 00 00
		 10 00 00 00
		 00 00 51 A4
		 BD CC 86 CA
		 27 00 08 00
		 A8 E2 3E ED
		 D9 05 42 01
		 FE 0D 70 0A
		 75 E4 92 2A
		 36 06 09 20
		 27 00 14 00
		 00 20 45 05
		 B8 0A 1D FC
		 C1 1C FE 02
		 00 0C 25 12
		 74 18 02 2A
		 B9 4D 96 5B
		 6D 00 00 00
		 0D 00 00 00
		 00 00 EC D5
		 90 B2 65 CA
		 1D 00 00 00
		 1A F2 3E ED
		 A3 06 75 F2
		 D5 FC 3C 03
		 EC 0A 1A 22
		 C2 33 CC FF
		 07 10 00 00
		 7A 0B 66 46
		 1D 00 40 00
		 F2 01 0A FA
		 FF 00 00 00
		 00 00 00 00
		 00 00 00 00
		 00 00 00 00
		 00 00 00 00
		 00 00 00 00
		 00 00 00 00
		 00 00 00 00
		 00 00 00 00
		 00 00 00 00
		 00 00 00 00
		 00 00 00 00
		 00 00 00 00
		 00 00 00 00
		 00 00 00 00
		 00 00 00 00
		 00 00 00 00
		 00 00 00 00
		 00 00 00 00
	];
};
