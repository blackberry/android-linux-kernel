/* Copyright (c) 2013-2015, The Linux Foundation. All rights reserved.
 *
 * This program is free software; you can redistribute it and/or modify
 * it under the terms of the GNU General Public License version 2 and
 * only version 2 as published by the Free Software Foundation.
 *
 * This program is distributed in the hope that it will be useful,
 * but WITHOUT ANY WARRANTY; without even the implied warranty of
 * MERCHANTABILITY or FITNESS FOR A PARTICULAR PURPOSE.  See the
 * GNU General Public License for more details.
 */

&mdss_mdp {
	dsi_nt35596_1080_vid: qcom,mdss_dsi_nt35596_1080p_video {
		qcom,mdss-dsi-panel-name = "nt35596 1080p video mode dsi panel";
		qcom,mdss-dsi-panel-type = "dsi_video_mode";
		qcom,mdss-dsi-panel-framerate = <60>;
		qcom,mdss-dsi-virtual-channel-id = <0>;
		qcom,mdss-dsi-stream = <0>;
		qcom,mdss-dsi-panel-width = <1080>;
		qcom,mdss-dsi-panel-height = <1920>;
		qcom,mdss-dsi-h-front-porch = <100>;
		qcom,mdss-dsi-h-back-porch = <100>;
		qcom,mdss-dsi-h-pulse-width = <2>;
		qcom,mdss-dsi-h-sync-skew = <0>;
		qcom,mdss-dsi-v-back-porch = <4>;
		qcom,mdss-dsi-v-front-porch = <4>;
		qcom,mdss-dsi-v-pulse-width = <2>;
		qcom,mdss-dsi-h-left-border = <0>;
		qcom,mdss-dsi-h-right-border = <0>;
		qcom,mdss-dsi-v-top-border = <0>;
		qcom,mdss-dsi-v-bottom-border = <0>;
		qcom,mdss-dsi-bpp = <24>;
		qcom,mdss-dsi-underflow-color = <0xff>;
		qcom,mdss-dsi-border-color = <0>;
		qcom,mdss-dsi-on-command = [29 01 00 00 00 00 02 FF 05
			29 01 00 00 00 00 02 FB 01
			29 01 00 00 00 00 02 C5 31
			29 01 00 00 00 00 02 FF EE
			29 01 00 00 00 00 02 FB 01
			29 01 00 00 00 00 02 18 40
			29 01 00 00 00 00 02 18 00
			29 01 00 00 00 00 02 FF EE
			29 01 00 00 00 00 02 7C 31
			29 01 00 00 00 00 02 FB 01
			29 01 00 00 00 00 02 FF 01
			29 01 00 00 00 00 02 30 0F
			29 01 00 00 00 00 02 00 01
			29 01 00 00 00 00 02 01 55
			29 01 00 00 00 00 02 02 40
			29 01 00 00 00 00 02 05 50
			29 01 00 00 00 00 02 06 4A
			29 01 00 00 00 00 02 07 29
			29 01 00 00 00 00 02 08 0C
			29 01 00 00 00 00 02 0B 87
			29 01 00 00 00 00 02 0C 87
			29 01 00 00 00 00 02 0E B0
			29 01 00 00 00 00 02 0F B3
			29 01 00 00 00 00 02 11 20
			29 01 00 00 00 00 02 12 20
			29 01 00 00 00 00 02 13 03
			29 01 00 00 00 00 02 14 4A
			29 01 00 00 00 00 02 15 12
			29 01 00 00 00 00 02 16 12
			29 01 00 00 00 00 02 18 00
			29 01 00 00 00 00 02 19 77
			29 01 00 00 00 00 02 1A 55
			29 01 00 00 00 00 02 1B 13
			29 01 00 00 00 00 02 1C 00
			29 01 00 00 00 00 02 1D 00
			29 01 00 00 00 00 02 1E 00
			29 01 00 00 00 00 02 1F 00
			29 01 00 00 00 00 02 58 82
			29 01 00 00 00 00 02 59 02
			29 01 00 00 00 00 02 5A 02
			29 01 00 00 00 00 02 5B 02
			29 01 00 00 00 00 02 5C 82
			29 01 00 00 00 00 02 5D 82
			29 01 00 00 00 00 02 5E 02
			29 01 00 00 00 00 02 5F 02
			29 01 00 00 00 00 02 72 31
			29 01 00 00 00 00 02 FB 01
			29 01 00 00 00 00 02 FF 05
			29 01 00 00 00 00 02 00 01
			29 01 00 00 00 00 02 01 0B
			29 01 00 00 00 00 02 02 0C
			29 01 00 00 00 00 02 03 09
			29 01 00 00 00 00 02 04 0A
			29 01 00 00 00 00 02 05 00
			29 01 00 00 00 00 02 06 0F
			29 01 00 00 00 00 02 07 10
			29 01 00 00 00 00 02 08 1A
			29 01 00 00 00 00 02 09 00
			29 01 00 00 00 00 02 0A 00
			29 01 00 00 00 00 02 0B 00
			29 01 00 00 00 00 02 0C 00
			29 01 00 00 00 00 02 0D 13
			29 01 00 00 00 00 02 0E 15
			29 01 00 00 00 00 02 0F 17
			29 01 00 00 00 00 02 10 01
			29 01 00 00 00 00 02 11 0B
			29 01 00 00 00 00 02 12 0C
			29 01 00 00 00 00 02 13 09
			29 01 00 00 00 00 02 14 0A
			29 01 00 00 00 00 02 15 00
			29 01 00 00 00 00 02 16 0F
			29 01 00 00 00 00 02 17 10
			29 01 00 00 00 00 02 18 1A
			29 01 00 00 00 00 02 19 00
			29 01 00 00 00 00 02 1A 00
			29 01 00 00 00 00 02 1B 00
			29 01 00 00 00 00 02 1C 00
			29 01 00 00 00 00 02 1D 13
			29 01 00 00 00 00 02 1E 15
			29 01 00 00 00 00 02 1F 17
			29 01 00 00 00 00 02 20 00
			29 01 00 00 00 00 02 21 01
			29 01 00 00 00 00 02 22 00
			29 01 00 00 00 00 02 23 40
			29 01 00 00 00 00 02 24 40
			29 01 00 00 00 00 02 25 6D
			29 01 00 00 00 00 02 29 D8
			29 01 00 00 00 00 02 2A 2A
			29 01 00 00 00 00 02 2B 00
			29 01 00 00 00 00 02 B6 89
			29 01 00 00 00 00 02 B7 14
			29 01 00 00 00 00 02 B8 05
			29 01 00 00 00 00 02 4B 04
			29 01 00 00 00 00 02 4C 11
			29 01 00 00 00 00 02 4D 10
			29 01 00 00 00 00 02 4E 01
			29 01 00 00 00 00 02 4F 01
			29 01 00 00 00 00 02 50 10
			29 01 00 00 00 00 02 51 00
			29 01 00 00 00 00 02 52 00
			29 01 00 00 00 00 02 53 08
			29 01 00 00 00 00 02 54 01
			29 01 00 00 00 00 02 55 6D
			29 01 00 00 00 00 02 5B 44
			29 01 00 00 00 00 02 5C 00
			29 01 00 00 00 00 02 5F 74
			29 01 00 00 00 00 02 60 75
			29 01 00 00 00 00 02 63 FF
			29 01 00 00 00 00 02 64 00
			29 01 00 00 00 00 02 67 04
			29 01 00 00 00 00 02 68 04
			29 01 00 00 00 00 02 6C 00
			29 01 00 00 00 00 02 7A 80
			29 01 00 00 00 00 02 7B 91
			29 01 00 00 00 00 02 7C D8
			29 01 00 00 00 00 02 7D 60
			29 01 00 00 00 00 02 7F 15
			29 01 00 00 00 00 02 80 00
			29 01 00 00 00 00 02 83 00
			29 01 00 00 00 00 02 93 08
			29 01 00 00 00 00 02 94 0A
			29 01 00 00 00 00 02 8A 00
			29 01 00 00 00 00 02 9B 0F
			29 01 00 00 00 00 02 FF 01
			29 01 00 00 00 00 02 FB 01
			29 01 00 00 00 00 02 75 00
			29 01 00 00 00 00 02 76 9D
			29 01 00 00 00 00 02 77 00
			29 01 00 00 00 00 02 78 A2
			29 01 00 00 00 00 02 79 00
			29 01 00 00 00 00 02 7A B0
			29 01 00 00 00 00 02 7B 00
			29 01 00 00 00 00 02 7C BD
			29 01 00 00 00 00 02 7D 00
			29 01 00 00 00 00 02 7E C9
			29 01 00 00 00 00 02 7F 00
			29 01 00 00 00 00 02 80 D4
			29 01 00 00 00 00 02 81 00
			29 01 00 00 00 00 02 82 DF
			29 01 00 00 00 00 02 83 00
			29 01 00 00 00 00 02 84 E9
			29 01 00 00 00 00 02 85 00
			29 01 00 00 00 00 02 86 F2
			29 01 00 00 00 00 02 87 01
			29 01 00 00 00 00 02 88 17
			29 01 00 00 00 00 02 89 01
			29 01 00 00 00 00 02 8A 36
			29 01 00 00 00 00 02 8B 01
			29 01 00 00 00 00 02 8C 6B
			29 01 00 00 00 00 02 8D 01
			29 01 00 00 00 00 02 8E 98
			29 01 00 00 00 00 02 8F 01
			29 01 00 00 00 00 02 90 E0
			29 01 00 00 00 00 02 91 02
			29 01 00 00 00 00 02 92 19
			29 01 00 00 00 00 02 93 02
			29 01 00 00 00 00 02 94 1A
			29 01 00 00 00 00 02 95 02
			29 01 00 00 00 00 02 96 4E
			29 01 00 00 00 00 02 97 02
			29 01 00 00 00 00 02 98 85
			29 01 00 00 00 00 02 99 02
			29 01 00 00 00 00 02 9A A9
			29 01 00 00 00 00 02 9B 02
			29 01 00 00 00 00 02 9C D9
			29 01 00 00 00 00 02 9D 02
			29 01 00 00 00 00 02 9E FB
			29 01 00 00 00 00 02 9F 03
			29 01 00 00 00 00 02 A0 28
			29 01 00 00 00 00 02 A2 03
			29 01 00 00 00 00 02 A3 35
			29 01 00 00 00 00 02 A4 03
			29 01 00 00 00 00 02 A5 44
			29 01 00 00 00 00 02 A6 03
			29 01 00 00 00 00 02 A7 54
			29 01 00 00 00 00 02 A9 03
			29 01 00 00 00 00 02 AA 67
			29 01 00 00 00 00 02 AB 03
			29 01 00 00 00 00 02 AC 7D
			29 01 00 00 00 00 02 AD 03
			29 01 00 00 00 00 02 AE 91
			29 01 00 00 00 00 02 AF 03
			29 01 00 00 00 00 02 B0 A7
			29 01 00 00 00 00 02 B1 03
			29 01 00 00 00 00 02 B2 CB
			29 01 00 00 00 00 02 B3 00
			29 01 00 00 00 00 02 B4 9D
			29 01 00 00 00 00 02 B5 00
			29 01 00 00 00 00 02 B6 A2
			29 01 00 00 00 00 02 B7 00
			29 01 00 00 00 00 02 B8 B0
			29 01 00 00 00 00 02 B9 00
			29 01 00 00 00 00 02 BA BD
			29 01 00 00 00 00 02 BB 00
			29 01 00 00 00 00 02 BC C9
			29 01 00 00 00 00 02 BD 00
			29 01 00 00 00 00 02 BE D4
			29 01 00 00 00 00 02 BF 00
			29 01 00 00 00 00 02 C0 DF
			29 01 00 00 00 00 02 C1 00
			29 01 00 00 00 00 02 C2 E9
			29 01 00 00 00 00 02 C3 00
			29 01 00 00 00 00 02 C4 F2
			29 01 00 00 00 00 02 C5 01
			29 01 00 00 00 00 02 C6 17
			29 01 00 00 00 00 02 C7 01
			29 01 00 00 00 00 02 C8 36
			29 01 00 00 00 00 02 C9 01
			29 01 00 00 00 00 02 CA 6B
			29 01 00 00 00 00 02 CB 01
			29 01 00 00 00 00 02 CC 98
			29 01 00 00 00 00 02 CD 01
			29 01 00 00 00 00 02 CE E0
			29 01 00 00 00 00 02 CF 02
			29 01 00 00 00 00 02 D0 19
			29 01 00 00 00 00 02 D1 02
			29 01 00 00 00 00 02 D2 1A
			29 01 00 00 00 00 02 D3 02
			29 01 00 00 00 00 02 D4 4E
			29 01 00 00 00 00 02 D5 02
			29 01 00 00 00 00 02 D6 85
			29 01 00 00 00 00 02 D7 02
			29 01 00 00 00 00 02 D8 A9
			29 01 00 00 00 00 02 D9 02
			29 01 00 00 00 00 02 DA D9
			29 01 00 00 00 00 02 DB 02
			29 01 00 00 00 00 02 DC FB
			29 01 00 00 00 00 02 DD 03
			29 01 00 00 00 00 02 DE 28
			29 01 00 00 00 00 02 DF 03
			29 01 00 00 00 00 02 E0 35
			29 01 00 00 00 00 02 E1 03
			29 01 00 00 00 00 02 E2 44
			29 01 00 00 00 00 02 E3 03
			29 01 00 00 00 00 02 E4 54
			29 01 00 00 00 00 02 E5 03
			29 01 00 00 00 00 02 E6 67
			29 01 00 00 00 00 02 E7 03
			29 01 00 00 00 00 02 E8 7D
			29 01 00 00 00 00 02 E9 03
			29 01 00 00 00 00 02 EA 91
			29 01 00 00 00 00 02 EB 03
			29 01 00 00 00 00 02 EC A7
			29 01 00 00 00 00 02 ED 03
			29 01 00 00 00 00 02 EE CB
			29 01 00 00 00 00 02 EF 00
			29 01 00 00 00 00 02 F0 7D
			29 01 00 00 00 00 02 F1 00
			29 01 00 00 00 00 02 F2 81
			29 01 00 00 00 00 02 F3 00
			29 01 00 00 00 00 02 F4 94
			29 01 00 00 00 00 02 F5 00
			29 01 00 00 00 00 02 F6 A2
			29 01 00 00 00 00 02 F7 00
			29 01 00 00 00 00 02 F8 AF
			29 01 00 00 00 00 02 F9 00
			29 01 00 00 00 00 02 FA BC
			29 01 00 00 00 00 02 FF 02
			29 01 00 00 00 00 02 FB 01
			29 01 00 00 00 00 02 00 00
			29 01 00 00 00 00 02 01 C8
			29 01 00 00 00 00 02 02 00
			29 01 00 00 00 00 02 03 D4
			29 01 00 00 00 00 02 04 00
			29 01 00 00 00 00 02 05 DF
			29 01 00 00 00 00 02 06 01
			29 01 00 00 00 00 02 07 06
			29 01 00 00 00 00 02 08 01
			29 01 00 00 00 00 02 09 28
			29 01 00 00 00 00 02 0A 01
			29 01 00 00 00 00 02 0B 61
			29 01 00 00 00 00 02 0C 01
			29 01 00 00 00 00 02 0D 8F
			29 01 00 00 00 00 02 0E 01
			29 01 00 00 00 00 02 0F DA
			29 01 00 00 00 00 02 10 02
			29 01 00 00 00 00 02 11 15
			29 01 00 00 00 00 02 12 02
			29 01 00 00 00 00 02 13 17
			29 01 00 00 00 00 02 14 02
			29 01 00 00 00 00 02 15 4C
			29 01 00 00 00 00 02 16 02
			29 01 00 00 00 00 02 17 83
			29 01 00 00 00 00 02 18 02
			29 01 00 00 00 00 02 19 A7
			29 01 00 00 00 00 02 1A 02
			29 01 00 00 00 00 02 1B D8
			29 01 00 00 00 00 02 1C 02
			29 01 00 00 00 00 02 1D FA
			29 01 00 00 00 00 02 1E 03
			29 01 00 00 00 00 02 1F 27
			29 01 00 00 00 00 02 20 03
			29 01 00 00 00 00 02 21 35
			29 01 00 00 00 00 02 22 03
			29 01 00 00 00 00 02 23 44
			29 01 00 00 00 00 02 24 03
			29 01 00 00 00 00 02 25 55
			29 01 00 00 00 00 02 26 03
			29 01 00 00 00 00 02 27 67
			29 01 00 00 00 00 02 28 03
			29 01 00 00 00 00 02 29 7F
			29 01 00 00 00 00 02 2A 03
			29 01 00 00 00 00 02 2B 92
			29 01 00 00 00 00 02 2D 03
			29 01 00 00 00 00 02 2F AA
			29 01 00 00 00 00 02 30 03
			29 01 00 00 00 00 02 31 CB
			29 01 00 00 00 00 02 32 00
			29 01 00 00 00 00 02 33 7D
			29 01 00 00 00 00 02 34 00
			29 01 00 00 00 00 02 35 81
			29 01 00 00 00 00 02 36 00
			29 01 00 00 00 00 02 37 94
			29 01 00 00 00 00 02 38 00
			29 01 00 00 00 00 02 39 A2
			29 01 00 00 00 00 02 3A 00
			29 01 00 00 00 00 02 3B AF
			29 01 00 00 00 00 02 3D 00
			29 01 00 00 00 00 02 3F BC
			29 01 00 00 00 00 02 40 00
			29 01 00 00 00 00 02 41 C8
			29 01 00 00 00 00 02 42 00
			29 01 00 00 00 00 02 43 D4
			29 01 00 00 00 00 02 44 00
			29 01 00 00 00 00 02 45 DF
			29 01 00 00 00 00 02 46 01
			29 01 00 00 00 00 02 47 06
			29 01 00 00 00 00 02 48 01
			29 01 00 00 00 00 02 49 28
			29 01 00 00 00 00 02 4A 01
			29 01 00 00 00 00 02 4B 61
			29 01 00 00 00 00 02 4C 01
			29 01 00 00 00 00 02 4D 8F
			29 01 00 00 00 00 02 4E 01
			29 01 00 00 00 00 02 4F DA
			29 01 00 00 00 00 02 50 02
			29 01 00 00 00 00 02 51 15
			29 01 00 00 00 00 02 52 02
			29 01 00 00 00 00 02 53 17
			29 01 00 00 00 00 02 54 02
			29 01 00 00 00 00 02 55 4C
			29 01 00 00 00 00 02 56 02
			29 01 00 00 00 00 02 58 83
			29 01 00 00 00 00 02 59 02
			29 01 00 00 00 00 02 5A A7
			29 01 00 00 00 00 02 5B 02
			29 01 00 00 00 00 02 5C D8
			29 01 00 00 00 00 02 5D 02
			29 01 00 00 00 00 02 5E FA
			29 01 00 00 00 00 02 5F 03
			29 01 00 00 00 00 02 60 27
			29 01 00 00 00 00 02 61 03
			29 01 00 00 00 00 02 62 35
			29 01 00 00 00 00 02 63 03
			29 01 00 00 00 00 02 64 44
			29 01 00 00 00 00 02 65 03
			29 01 00 00 00 00 02 66 55
			29 01 00 00 00 00 02 67 03
			29 01 00 00 00 00 02 68 67
			29 01 00 00 00 00 02 69 03
			29 01 00 00 00 00 02 6A 7F
			29 01 00 00 00 00 02 6B 03
			29 01 00 00 00 00 02 6C 92
			29 01 00 00 00 00 02 6D 03
			29 01 00 00 00 00 02 6E AA
			29 01 00 00 00 00 02 6F 03
			29 01 00 00 00 00 02 70 CB
			29 01 00 00 00 00 02 71 00
			29 01 00 00 00 00 02 72 00
			29 01 00 00 00 00 02 73 00
			29 01 00 00 00 00 02 74 21
			29 01 00 00 00 00 02 75 00
			29 01 00 00 00 00 02 76 4C
			29 01 00 00 00 00 02 77 00
			29 01 00 00 00 00 02 78 6B
			29 01 00 00 00 00 02 79 00
			29 01 00 00 00 00 02 7A 85
			29 01 00 00 00 00 02 7B 00
			29 01 00 00 00 00 02 7C 9A
			29 01 00 00 00 00 02 7D 00
			29 01 00 00 00 00 02 7E AD
			29 01 00 00 00 00 02 7F 00
			29 01 00 00 00 00 02 80 BE
			29 01 00 00 00 00 02 81 00
			29 01 00 00 00 00 02 82 CD
			29 01 00 00 00 00 02 83 01
			29 01 00 00 00 00 02 84 01
			29 01 00 00 00 00 02 85 01
			29 01 00 00 00 00 02 86 29
			29 01 00 00 00 00 02 87 01
			29 01 00 00 00 00 02 88 68
			29 01 00 00 00 00 02 89 01
			29 01 00 00 00 00 02 8A 98
			29 01 00 00 00 00 02 8B 01
			29 01 00 00 00 00 02 8C E5
			29 01 00 00 00 00 02 8D 02
			29 01 00 00 00 00 02 8E 1E
			29 01 00 00 00 00 02 8F 02
			29 01 00 00 00 00 02 90 20
			29 01 00 00 00 00 02 91 02
			29 01 00 00 00 00 02 92 52
			29 01 00 00 00 00 02 93 02
			29 01 00 00 00 00 02 94 88
			29 01 00 00 00 00 02 95 02
			29 01 00 00 00 00 02 96 AA
			29 01 00 00 00 00 02 97 02
			29 01 00 00 00 00 02 98 D7
			29 01 00 00 00 00 02 99 02
			29 01 00 00 00 00 02 9A F7
			29 01 00 00 00 00 02 9B 03
			29 01 00 00 00 00 02 9C 21
			29 01 00 00 00 00 02 9D 03
			29 01 00 00 00 00 02 9E 2E
			29 01 00 00 00 00 02 9F 03
			29 01 00 00 00 00 02 A0 3D
			29 01 00 00 00 00 02 A2 03
			29 01 00 00 00 00 02 A3 4C
			29 01 00 00 00 00 02 A4 03
			29 01 00 00 00 00 02 A5 5E
			29 01 00 00 00 00 02 A6 03
			29 01 00 00 00 00 02 A7 71
			29 01 00 00 00 00 02 A9 03
			29 01 00 00 00 00 02 AA 86
			29 01 00 00 00 00 02 AB 03
			29 01 00 00 00 00 02 AC 94
			29 01 00 00 00 00 02 AD 03
			29 01 00 00 00 00 02 AE FA
			29 01 00 00 00 00 02 AF 00
			29 01 00 00 00 00 02 B0 00
			29 01 00 00 00 00 02 B1 00
			29 01 00 00 00 00 02 B2 21
			29 01 00 00 00 00 02 B3 00
			29 01 00 00 00 00 02 B4 4C
			29 01 00 00 00 00 02 B5 00
			29 01 00 00 00 00 02 B6 6B
			29 01 00 00 00 00 02 B7 00
			29 01 00 00 00 00 02 B8 85
			29 01 00 00 00 00 02 B9 00
			29 01 00 00 00 00 02 BA 9A
			29 01 00 00 00 00 02 BB 00
			29 01 00 00 00 00 02 BC AD
			29 01 00 00 00 00 02 BD 00
			29 01 00 00 00 00 02 BE BE
			29 01 00 00 00 00 02 BF 00
			29 01 00 00 00 00 02 C0 CD
			29 01 00 00 00 00 02 C1 01
			29 01 00 00 00 00 02 C2 01
			29 01 00 00 00 00 02 C3 01
			29 01 00 00 00 00 02 C4 29
			29 01 00 00 00 00 02 C5 01
			29 01 00 00 00 00 02 C6 68
			29 01 00 00 00 00 02 C7 01
			29 01 00 00 00 00 02 C8 98
			29 01 00 00 00 00 02 C9 01
			29 01 00 00 00 00 02 CA E5
			29 01 00 00 00 00 02 CB 02
			29 01 00 00 00 00 02 CC 1E
			29 01 00 00 00 00 02 CD 02
			29 01 00 00 00 00 02 CE 20
			29 01 00 00 00 00 02 CF 02
			29 01 00 00 00 00 02 D0 52
			29 01 00 00 00 00 02 D1 02
			29 01 00 00 00 00 02 D2 88
			29 01 00 00 00 00 02 D3 02
			29 01 00 00 00 00 02 D4 AA
			29 01 00 00 00 00 02 D5 02
			29 01 00 00 00 00 02 D6 D7
			29 01 00 00 00 00 02 D7 02
			29 01 00 00 00 00 02 D8 F7
			29 01 00 00 00 00 02 D9 03
			29 01 00 00 00 00 02 DA 21
			29 01 00 00 00 00 02 DB 03
			29 01 00 00 00 00 02 DC 2E
			29 01 00 00 00 00 02 DD 03
			29 01 00 00 00 00 02 DE 3D
			29 01 00 00 00 00 02 DF 03
			29 01 00 00 00 00 02 E0 4C
			29 01 00 00 00 00 02 E1 03
			29 01 00 00 00 00 02 E2 5E
			29 01 00 00 00 00 02 E3 03
			29 01 00 00 00 00 02 E4 71
			29 01 00 00 00 00 02 E5 03
			29 01 00 00 00 00 02 E6 86
			29 01 00 00 00 00 02 E7 03
			29 01 00 00 00 00 02 E8 94
			29 01 00 00 00 00 02 E9 03
			29 01 00 00 00 00 02 EA FA
			29 01 00 00 00 00 02 FF 05
			29 01 00 00 00 00 02 FB 01
			29 01 00 00 00 00 02 E7 80
			29 01 00 00 00 00 02 FB 01
			29 01 00 00 00 00 02 EC 00
			29 01 00 00 00 00 02 FF 00
			29 01 00 00 00 00 02 D3 06
			29 01 00 00 00 00 02 D4 04
			29 01 00 00 00 00 02 FF 00
			29 01 00 00 00 00 02 35 00
			29 01 00 00 C8 00 02 11 00
//			29 01 00 00 00 00 02 FF 00
//			29 01 00 00 00 00 02 35 00
			29 01 00 00 78 00 02 29 00];
		qcom,mdss-dsi-off-command = [05 01 00 00 32 00 02 28 00
					05 01 00 00 78 00 02 10 00];
		qcom,mdss-dsi-on-command-state = "dsi_lp_mode";
		qcom,mdss-dsi-off-command-state = "dsi_hs_mode";
		qcom,mdss-dsi-h-sync-pulse = <1>;
		qcom,mdss-dsi-traffic-mode = "burst_mode";
		qcom,mdss-dsi-bllp-eof-power-mode;
		qcom,mdss-dsi-bllp-power-mode;
		qcom,mdss-dsi-lane-0-state;
		qcom,mdss-dsi-lane-1-state;
		qcom,mdss-dsi-lane-2-state;
		qcom,mdss-dsi-lane-3-state;
		qcom,mdss-dsi-panel-timings = [E6 38 26 00 68 6C 2A 3A 2C 03 04 00];
		qcom,mdss-dsi-t-clk-post = <0x02>;
		qcom,mdss-dsi-t-clk-pre = <0x2B>;
		qcom,mdss-dsi-bl-min-level = <1>;
		qcom,mdss-dsi-bl-max-level = <4095>;
		qcom,mdss-dsi-dma-trigger = "trigger_sw";
		qcom,mdss-dsi-mdp-trigger = "none";
		qcom,mdss-dsi-bl-pmic-control-type = "bl_ctrl_wled";
		qcom,mdss-dsi-reset-sequence = <1 20>, <0 1>, <1 20>;

	};
};


