/*TCL sun zhangyang add for idol4 battery profile, task965190,2015.11.19*/
qcom,tcl-idol4-2600mah {
	/*#2208052_TCL_TLp026EJ_2600mAh_averaged_MasterSlave_Nov18th2015*/
	qcom,max-voltage-uv = <4400000>;
	qcom,nom-batt-capacity-mah = <2600>;
	qcom,batt-id-kohm = <2>;
	qcom,battery-beta = <3435>;
	qcom,default-battery-type;
	qcom,battery-type = "tcl_idol4_2600mah";

        qcom,v-cutoff-uv = <3400000>;
        qcom,chg-term-ua = <100000>;
        qcom,fg-cc-cv-threshold-mv = <4390>;

	qcom,chg-rslow-comp-c1 = <4654604>;
	qcom,chg-rslow-comp-c2 = <9210694>;
	qcom,chg-rs-to-rslow = <1231247>;
	qcom,chg-rslow-comp-thr = <0xBE>;
	qcom,checksum = <0x7AA2>;
	qcom,gui-version = "PMI8950GUI - 2.0.0.14";
	qcom,fg-profile-data = [
		 DD 83 AF 7C 
		 0B 81 45 77 
		 61 83 A4 6F 
		 20 89 37 94 
		 12 82 FF 99 
		 B6 BC 02 C9 
		 57 11 EF 83 
		 D1 7C FE 80 
		 F5 76 4A 83 
		 20 71 7B 62 
		 AC 7F 66 82 
		 4F 98 1A B6 
		 B0 C1 58 0E 
		 89 0A 4C 5A 
		 14 70 01 FE 
		 FC 36 93 45 
		 02 42 00 00 
		 CC 46 C4 3B 
		 26 3C 00 00 
		 00 00 00 00 
		 00 00 00 00 
		 BB 71 F0 6B 
		 BD 75 83 89 
		 04 7E 64 73 
		 38 75 44 73 
		 75 7C DE 70 
		 C2 53 D8 A3 
		 27 BC 60 DF 
		 5E A0 71 0C 
		 28 00 FF 36 
		 F0 11 30 03 
		 00 00 00 0C 
	];
};
