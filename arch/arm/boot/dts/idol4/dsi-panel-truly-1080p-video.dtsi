/* Copyright (c) 2015, The Linux Foundation. All rights reserved.
 *
 * This program is free software; you can redistribute it and/or modify
 * it under the terms of the GNU General Public License version 2 and
 * only version 2 as published by the Free Software Foundation.
 *
 * This program is distributed in the hope that it will be useful,
 * but WITHOUT ANY WARRANTY; without even the implied warranty of
 * MERCHANTABILITY or FITNESS FOR A PARTICULAR PURPOSE.  See the
 * GNU General Public License for more details.
 */

&mdss_mdp {
	dsi_truly_1080_vid: qcom,mdss_dsi_truly_1080p_video {
		qcom,mdss-dsi-panel-name = "truly 1080p video mode dsi panel";
		qcom,mdss-dsi-panel-type = "dsi_video_mode";
		qcom,mdss-dsi-panel-framerate = <60>;
		qcom,mdss-dsi-virtual-channel-id = <0>;
		qcom,mdss-dsi-stream = <0>;
		qcom,mdss-dsi-panel-width = <1080>;
		qcom,mdss-dsi-panel-height = <1920>;
		/* MODIFIED-BEGIN by jianhua.yu, 2016-04-26,BUG-1997477*/
		qcom,mdss-dsi-h-front-porch = <90>;
		qcom,mdss-dsi-h-back-porch = <60>;
		qcom,mdss-dsi-h-pulse-width = <25>;
		qcom,mdss-dsi-h-sync-skew = <0>;
		qcom,mdss-dsi-v-front-porch = <10>;
		qcom,mdss-dsi-v-back-porch = <7>;
		qcom,mdss-dsi-v-pulse-width = <2>;
		/* MODIFIED-END by jianhua.yu,BUG-1997477*/
		qcom,mdss-dsi-h-left-border = <0>;
		qcom,mdss-dsi-h-right-border = <0>;
		qcom,mdss-dsi-v-top-border = <0>;
		qcom,mdss-dsi-v-bottom-border = <0>;
		qcom,mdss-dsi-bpp = <24>;
		qcom,mdss-dsi-underflow-color = <0xff>;
		qcom,mdss-dsi-border-color = <0>;
		/* MODIFIED-BEGIN by jianhua.yu, 2016-04-26,BUG-1997477*/
		qcom,mdss-dsi-on-command = [39 01 00 00 00 00 02 B0 04
		    39 01 00 00 00 00 02 D6 01
		    39 01 00 00 00 00 07
		          B3 14 00 00 00
		          00 00
		    39 01 00 00 00 00 03 B4 0C 00
		    39 01 00 00 00 00 04
		          B6 4B DB 16
		    39 01 00 00 00 00 03 BE 00 04
		    39 01 00 00 00 00 02 C0 00
		    39 01 00 00 00 00 23
		          C1 04 60 00
		          20 29 41 22
		          63 F0 FF FF
		          9B 7B CF B5
		          FF FF 87 8C
		          C5 11 54 02
		          00 00 00 00
		          00 22 11 02
		          21 00 FF
		    39 01 00 00 00 00 09
		          C2 30 F7 80
		          06 04 00 00
		          08
		    39 01 00 00 00 00 04 C3 00 00 00
		    39 01 00 00 00 00 0C
		          C4 70 00 00
		          00 00 00 00
		          00 00 00 04
		    39 01 00 00 00 00 02 C5 00
		    39 01 00 00 00 00 16
		          C6 C8 3C 3C
		          07 01 07 01
		          00 00 00 00
		          00 00 00 00
		          00 00 0E 1A
		          07 C8
		    39 01 00 00 00 00 1F
		          C7 01 14 1D
		          26 35 43 4D
		          5C 40 47 53
		          5F 76 7B 7C
		          01 14 1D 26
		          35 43 4D 5C
		          40 47 53 5F
		          76 7B 7C
		    39 01 00 00 00 00 10
		          CB FF E1 87
		          FF 00 00 00
		          00 FF E1 87
		          FF E8 00 00
		    39 01 00 00 00 00 02 CC 32
		    39 01 00 00 00 00 0B
		          D0 11 00 00
		          56 D4 40 19
		          19 09 00
		    39 01 00 00 00 00 05 D1 00 48 16 0F
		    39 01 00 00 00 00 1B
		          D3 1B 33 BB
		          BB B3 33 33
		          33 33 00 01
		          00 00 D8 A0
		          0C 33 33 33
		          33 72 12 8A
		          57 3D BC
		    39 01 00 00 00 00 08
		          D5 06 00 00
		          01 26 01 26
		    39 01 00 00 00 00 04 D8 00 00 00
		    39 01 00 00 00 00 04 D9 00 00 00
		    39 01 00 00 00 00 05 DE 00 3F FF 10
            39 01 00 00 01 00 2C
	              CA 1D FC FC FC
	              00 CA CA 96 00
	              96 C0 C0 00 82
	              00 00 00 9E 00
	              00 00 82 FF 9F
	              83 FF 9F 83 7D
	              00 00 00 00 00
	              00 00 00 00 00
	              00 00 00 00
		    39 01 00 00 14 00 02 29 00
		    39 01 00 00 3C 00 02 11 00];
		qcom,mdss-dsi-off-command = [05 01 00 00 14 00 02 28 00
				 05 01 00 00 78 00 02 10 00];
		qcom,mdss-dsi-on-command-state = "dsi_lp_mode";
		qcom,mdss-dsi-off-command-state = "dsi_lp_mode";
        qcom,mdss-dsi-traffic-mode = "burst_mode";
		qcom,mdss-dsi-bllp-eof-power-mode;
		qcom,mdss-dsi-bllp-power-mode;
		qcom,mdss-dsi-lane-0-state;
		qcom,mdss-dsi-lane-1-state;
		qcom,mdss-dsi-lane-2-state;
		qcom,mdss-dsi-lane-3-state;
		qcom,mdss-dsi-panel-timings = [E7 36 24 00 66 6A 2A 3A 2D 03 04 00];
		qcom,mdss-dsi-t-clk-post = <0x03>;
		qcom,mdss-dsi-t-clk-pre = <0x2B>;
		qcom,mdss-dsi-bl-min-level = <1>;
		qcom,mdss-dsi-bl-max-level = <4095>;
		qcom,mdss-dsi-dma-trigger = "trigger_sw";
		qcom,mdss-dsi-mdp-trigger = "none";
		qcom,mdss-dsi-bl-pmic-control-type = "bl_ctrl_wled";
		qcom,mdss-dsi-reset-sequence = <1 5>, <0 5>, <1 5>;//TCT-SH jhyu fix 2168016  05-18-2016
		qcom,mdss-dsi-post-init-delay = <1>;
		qcom,mdss-pan-physical-width-dimension = <65>;
		qcom,mdss-pan-physical-height-dimension = <115>;
		/* MODIFIED-END by jianhua.yu,BUG-1997477*/
	};
};

