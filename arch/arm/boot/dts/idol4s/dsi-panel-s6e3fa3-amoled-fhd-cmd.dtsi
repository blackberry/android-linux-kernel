/* Copyright (c) 2015, The Linux Foundation. All rights reserved.
 *
 * This program is free software; you can redistribute it and/or modify
 * it under the terms of the GNU General Public License version 2 and
 * only version 2 as published by the Free Software Foundation.
 *
 * This program is distributed in the hope that it will be useful,
 * but WITHOUT ANY WARRANTY; without even the implied warranty of
 * MERCHANTABILITY or FITNESS FOR A PARTICULAR PURPOSE.  See the
 * GNU General Public License for more details.
 */

&mdss_mdp {
	dsi_s6e3fa3_amoled_cmd: qcom,mdss_dsi_s6e3fa3_amoled_fhd_cmd{
		qcom,mdss-dsi-panel-name =
			"S6e3fa3 amoled cmd mode dsi panel without DSC";
		qcom,mdss-dsi-panel-controller = <&mdss_dsi0>;
		qcom,mdss-dsi-panel-type = "dsi_cmd_mode";
		qcom,mdss-dsi-panel-destination = "display_1";
		qcom,mdss-dsi-panel-framerate = <60>;
		qcom,mdss-dsi-virtual-channel-id = <0>;
		qcom,mdss-dsi-stream = <0>;
		qcom,mdss-dsi-panel-width = <1080>;
		qcom,mdss-dsi-panel-height = <1920>;
/* [BUGFIX]-Mod-BEGIN by TCTNB.CY, FR-898333, 2015/11/11, optimize dsi clk configure*/
		qcom,mdss-dsi-h-front-porch = <80>;
		qcom,mdss-dsi-h-back-porch = <80>;
		qcom,mdss-dsi-h-pulse-width = <40>;
/* [PLATFORM]-Mod-END by TCTNB.CY, 2015/11/11*/
		qcom,mdss-dsi-h-sync-skew = <0>;
		qcom,mdss-dsi-v-back-porch = <40>;
		qcom,mdss-dsi-v-front-porch = <40>;
		qcom,mdss-dsi-v-pulse-width = <40>;
		qcom,mdss-dsi-h-left-border = <0>;
		qcom,mdss-dsi-h-right-border = <0>;
		qcom,mdss-dsi-v-top-border = <0>;
		qcom,mdss-dsi-v-bottom-border = <0>;
		qcom,mdss-pan-physical-width-dimension = <68>;
		qcom,mdss-pan-physical-height-dimension = <121>;
		qcom,mdss-dsi-bpp = <24>;
		qcom,mdss-dsi-color-order = "rgb_swap_rgb";
		qcom,mdss-dsi-underflow-color = <0xff>;
		qcom,mdss-dsi-border-color = <0>;
		qcom,mdss-dsi-h-sync-pulse = <1>;
		qcom,mdss-dsi-traffic-mode = "burst_mode";//"non_burst_sync_event";
		qcom,mdss-dsi-bllp-eof-power-mode;
		qcom,mdss-dsi-bllp-power-mode;
		qcom,mdss-dsi-lane-0-state;
		qcom,mdss-dsi-lane-1-state;
		qcom,mdss-dsi-lane-2-state;
		qcom,mdss-dsi-lane-3-state;
/* [BUGFIX]-Mod-BEGIN by TCTNB.CY, FR-898333, 2015/11/11, optimize dsi clk configure*/
		qcom,mdss-dsi-panel-timings = [F2 3A 28 00 6C 70 2C 3E 2E 03 04 00];
		qcom,mdss-dsi-reset-sequence = <1 10>, <0 10>, <1 10>;
		qcom,mdss-dsi-t-clk-post = <0x02>;
		qcom,mdss-dsi-t-clk-pre = <0x2D>;
/* [PLATFORM]-Mod-END by TCTNB.CY, 2015/11/11*/
		qcom,mdss-dsi-bl-min-level = <4>;
		qcom,mdss-dsi-bl-max-level = <255>;
		qcom,mdss-dsi-dma-trigger = "trigger_sw";
		qcom,mdss-dsi-mdp-trigger = "none";
		qcom,mdss-dsi-te-pin-select = <1>;
		qcom,mdss-dsi-wr-mem-start = <0x2c>;
		qcom,mdss-dsi-wr-mem-continue = <0x3c>;
		qcom,mdss-dsi-te-dcs-command = <1>;
/* [BUGFIX]-Mod-BEGIN by TCTNB.CY, task-1220822, 2016/01/08, enable HW TE*/
		qcom,mdss-dsi-te-check-enable;
		qcom,mdss-dsi-te-using-te-pin;
/* [BUGFIX]-Mod-END by TCTNB.CY, 2016/01/08*/
//		qcom,ulps-enabled;
		qcom,mdss-dsi-on-command = [
/* [BUGFIX]-Mod-BEGIN by TCTNB.CY, task-975820, 2015/11/23, temp change for can not wake up*/
			05 01 00 00 00 00 02 00 00
/* [BUGFIX]-Mod-END by TCTNB.CY, 2015/11/23*/
			05 01 00 00 14 00 02 11 00
			15 01 00 00 00 00 02 35 00		//TE on
			//common setting
			39 01 00 00 00 00 03 fc 5a 5a
			39 01 00 00 00 00 02 b0 1e
			39 01 00 00 00 00 02 fd 9e
			39 01 00 00 00 00 03 fc a5 a5
/* [BUGFIX]-Mod-BEGIN by TCTNB.CY, task-929771, 2015/11/17, enable hsync for tp*/
			39 01 00 00 00 00 03 f0 5a 5a
			39 01 00 00 00 00 03 bc 11 11
			39 01 00 00 00 00 02 ed 4d
			39 01 00 00 00 00 03 f0 a5 a5
/* [BUGFIX]-Mod-END by TCTNB.CY, 2015/11/17*/
			//brightness setting
			15 01 00 00 00 00 02 53 20
			15 01 00 00 00 00 02 51 00		/* [BUGFIX]-Mod-by TCTNB.CY, task-978208, 2015/11/24, set default brightness to 0*/
			15 01 00 00 96 00 02 55 00		//ACL off

			05 01 00 00 00 00 02 2c 00
			05 01 00 00 00 00 02 29 00];

		qcom,mdss-dsi-off-command = [
			05 01 00 00 32 00 02 28 00
			05 01 00 00 78 00 02 10 00];

		qcom,mdss-dsi-on-command-state = "dsi_hs_mode";		/* [BUGFIX]-Mod by TCTNB.CY, FR-989087, 2015/11/27, change send cmd mode to hs mode*/
		qcom,mdss-dsi-off-command-state = "dsi_hs_mode";
		qcom,mdss-dsi-bl-pmic-control-type = "bl_ctrl_dcs";
		qcom,mdss-dsi-lp11-init;
	};
/* [PLATFORM]-Mod-BEGIN by TCTNB.CY, FR-764135, 2015/10/20, add panel node for pmi8952 amoled power supply*/
	dsi_s6e3fa3_amoled_pmic_cmd: qcom,mdss_dsi_s6e3fa3_amoled_fhd_pmic_cmd{
/*[BUGFIX]-Mod-BEGIN by TCTNB.CY, FR-904888, 2015/11/13, modify panel name string for xml file*/
		qcom,mdss-dsi-panel-name =
			"S6e3fa3 amoled cmd mode dsi panel without DSC powered by pmi8952";
/* [BUGFIX]-Mod-END by TCTNB.CY, 2015/11/13*/
		qcom,mdss-dsi-panel-controller = <&mdss_dsi0>;
		qcom,mdss-dsi-panel-type = "dsi_cmd_mode";
		qcom,mdss-dsi-panel-destination = "display_1";
		qcom,mdss-dsi-panel-framerate = <60>;
		qcom,mdss-dsi-virtual-channel-id = <0>;
		qcom,mdss-dsi-stream = <0>;
		qcom,mdss-dsi-panel-width = <1080>;
		qcom,mdss-dsi-panel-height = <1920>;
/* [BUGFIX]-Mod-BEGIN by TCTNB.CY, FR-898333, 2015/11/11, optimize dsi clk configure*/
		qcom,mdss-dsi-h-front-porch = <80>;
		qcom,mdss-dsi-h-back-porch = <80>;
		qcom,mdss-dsi-h-pulse-width = <40>;
/* [PLATFORM]-Mod-END by TCTNB.CY, 2015/11/11*/
		qcom,mdss-dsi-h-sync-skew = <0>;
		qcom,mdss-dsi-v-back-porch = <40>;
		qcom,mdss-dsi-v-front-porch = <40>;
		qcom,mdss-dsi-v-pulse-width = <40>;
		qcom,mdss-dsi-h-left-border = <0>;
		qcom,mdss-dsi-h-right-border = <0>;
		qcom,mdss-dsi-v-top-border = <0>;
		qcom,mdss-dsi-v-bottom-border = <0>;
		qcom,mdss-pan-physical-width-dimension = <68>;
		qcom,mdss-pan-physical-height-dimension = <121>;
		qcom,mdss-dsi-bpp = <24>;
		qcom,mdss-dsi-color-order = "rgb_swap_rgb";
		qcom,mdss-dsi-underflow-color = <0xff>;
		qcom,mdss-dsi-border-color = <0>;
		qcom,mdss-dsi-h-sync-pulse = <1>;
		qcom,mdss-dsi-traffic-mode = "burst_mode";//"non_burst_sync_event";
		qcom,mdss-dsi-bllp-eof-power-mode;
		qcom,mdss-dsi-bllp-power-mode;
		qcom,mdss-dsi-lane-0-state;
		qcom,mdss-dsi-lane-1-state;
		qcom,mdss-dsi-lane-2-state;
		qcom,mdss-dsi-lane-3-state;
/* [BUGFIX]-Mod-BEGIN by TCTNB.CY, FR-898333, 2015/11/11, optimize dsi clk configure*/
		qcom,mdss-dsi-panel-timings = [F2 3A 28 00 6C 70 2C 3E 2E 03 04 00];
		qcom,mdss-dsi-reset-sequence = <1 10>, <0 10>, <1 10>;
		qcom,mdss-dsi-t-clk-post = <0x02>;
		qcom,mdss-dsi-t-clk-pre = <0x2D>;
/* [PLATFORM]-Mod-END by TCTNB.CY, 2015/11/11*/
		qcom,mdss-dsi-bl-min-level = <4>;
		qcom,mdss-dsi-bl-max-level = <255>;
		qcom,mdss-dsi-dma-trigger = "trigger_sw";
		qcom,mdss-dsi-mdp-trigger = "none";
		qcom,mdss-dsi-te-pin-select = <1>;
		qcom,mdss-dsi-wr-mem-start = <0x2c>;
		qcom,mdss-dsi-wr-mem-continue = <0x3c>;
		qcom,mdss-dsi-te-dcs-command = <1>;
/* [BUGFIX]-Mod-BEGIN by TCTNB.CY, task-1220822, 2016/01/08, enable HW TE*/
		qcom,mdss-dsi-te-check-enable;
		qcom,mdss-dsi-te-using-te-pin;
/* [BUGFIX]-Mod-END by TCTNB.CY, 2016/01/08*/
//		qcom,ulps-enabled;
		qcom,mdss-dsi-on-command = [
/* [BUGFIX]-Mod-BEGIN by TCTNB.CY, task-975820, 2015/11/23, temp change for can not wake up*/
			05 01 00 00 00 00 02 00 00
/* [BUGFIX]-Mod-END by TCTNB.CY, 2015/11/23*/
			05 01 00 00 14 00 02 11 00
			15 01 00 00 00 00 02 35 00		//TE on
			//common setting
			39 01 00 00 00 00 03 fc 5a 5a
			39 01 00 00 00 00 02 b0 1e
			39 01 00 00 00 00 02 fd 9e
			39 01 00 00 00 00 03 fc a5 a5
/* [BUGFIX]-Mod-BEGIN by TCTNB.CY, task-929771, 2015/11/17, enable hsync for tp*/
			39 01 00 00 00 00 03 f0 5a 5a
			39 01 00 00 00 00 03 bc 11 11
			39 01 00 00 00 00 02 ed 4d
			39 01 00 00 00 00 03 f0 a5 a5
/* [BUGFIX]-Mod-END by TCTNB.CY, 2015/11/17*/
			//brightness setting
			15 01 00 00 00 00 02 53 20
			15 01 00 00 00 00 02 51 00		/* [BUGFIX]-Mod-by TCTNB.CY, task-978208, 2015/11/24, set default brightness to 0*/
			15 01 00 00 96 00 02 55 00		//ACL off

			05 01 00 00 00 00 02 2c 00
			05 01 00 00 00 00 02 29 00];

		qcom,mdss-dsi-off-command = [
			05 01 00 00 32 00 02 28 00
			05 01 00 00 78 00 02 10 00];

		qcom,mdss-dsi-on-command-state = "dsi_hs_mode";		/* [BUGFIX]-Mod by TCTNB.CY, FR-989087, 2015/11/27, change send cmd mode to hs mode*/
		qcom,mdss-dsi-off-command-state = "dsi_hs_mode";
		qcom,mdss-dsi-bl-pmic-control-type = "bl_ctrl_dcs";
		qcom,mdss-dsi-lp11-init;
	};
/* [PLATFORM]-Mod-END by TCTNB.CY, 2015/10/20*/
};
