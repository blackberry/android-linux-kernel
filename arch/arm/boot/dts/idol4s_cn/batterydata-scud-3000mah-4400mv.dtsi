/* Copyright (c) 2014-2015, The Linux Foundation. All rights reserved.
 *
 * This program is free software; you can redistribute it and/or modify
 * it under the terms of the GNU General Public License version 2 and
 * only version 2 as published by the Free Software Foundation.
 *
 * This program is distributed in the hope that it will be useful,
 * but WITHOUT ANY WARRANTY; without even the implied warranty of
 * MERCHANTABILITY or FITNESS FOR A PARTICULAR PURPOSE.  See the
 * GNU General Public License for more details.
 */

qcom,scud-3000mah-4400mv {
	/* #2233619_TCL_Idol4S_Scud_TLp030F2_3000mAh_averaged_MasterSlave_Nov16th2015*/
	qcom,max-voltage-uv = <4400000>;
	qcom,nom-batt-capacity-mah = <3000>;
	qcom,batt-id-kohm = <51 45>;
	qcom,battery-beta = <3435>;
	qcom,battery-type = "scud";
	qcom,thermal-coefficients = [c2 86 bb 50 cf 37];

	qcom,v-cutoff-uv = <3400000>;
	qcom,chg-term-ua = <100000>;
	qcom,fastchg-current-ma = <3000>;
	qcom,fg-cc-cv-threshold-mv = <4390>;
	
	qcom,chg-rslow-comp-c1 = <3200343>;
	qcom,chg-rslow-comp-c2 = <4448731>;
	qcom,chg-rs-to-rslow = <864404>;
	qcom,chg-rslow-comp-thr = <0xA3>;
	qcom,checksum = <0x1481>;
	qcom,gui-version = "PMI8950GUI - 2.0.0.14";
	qcom,fg-profile-data = [
		 F2 83 A4 7D 
		 D8 81 6F 7C 
		 52 83 B8 50 
		 3C 80 65 86 
		 DA 81 15 9A 
		 15 BC 50 C3 
		 6A 19 09 88 
		 4F 7E 49 82 
		 D7 7C 5B 83 
		 BF 4F B9 82 
		 31 8E 3A 82 
		 A8 98 34 B6 
		 8F C1 58 18 
		 1E 0C 9A 5B 
		 14 70 71 FD 
		 62 44 81 4C 
		 A5 48 00 00 
		 23 46 5D 30 
		 FD 1E 00 00 
		 00 00 00 00 
		 00 00 00 00 
		 3B 70 2D 6A 
		 3A 71 ED 8A 
		 3E 7C 34 70 
		 68 6E 48 7A 
		 96 75 8A 62 
		 FA 6E BB AA 
		 21 60 61 FB 
		 5F A0 71 0C 
		 28 00 FF 36 
		 F0 11 30 03 
		 00 00 00 0C 
	];
};
