/* Copyright (c) 2015, The Linux Foundation. All rights reserved.
 *
 * This program is free software; you can redistribute it and/or modify
 * it under the terms of the GNU General Public License version 2 and
 * only version 2 as published by the Free Software Foundation.
 *
 * This program is distributed in the hope that it will be useful,
 * but WITHOUT ANY WARRANTY; without even the implied warranty of
 * MERCHANTABILITY or FITNESS FOR A PARTICULAR PURPOSE.  See the
 * GNU General Public License for more details.
 */

&mdss_mdp {
	dsi_dual_s6e3ha3_amoled_cmd: qcom,mdss_dsi_s6e3ha3_amoled_wqhd_cmd{
		qcom,mdss-dsi-panel-name =
			"Dual s6e3ha3 amoled cmd mode dsi panel without DSC";
		qcom,mdss-dsi-panel-controller = <&mdss_dsi0>;
		qcom,mdss-dsi-panel-type = "dsi_cmd_mode";
		qcom,mdss-dsi-panel-destination = "display_1";
		qcom,mdss-dsi-panel-framerate = <60>;
		qcom,mdss-dsi-virtual-channel-id = <0>;
		qcom,mdss-dsi-stream = <0>;
		qcom,mdss-dsi-panel-width = <720>;
		qcom,mdss-dsi-panel-height = <2560>;
		qcom,mdss-dsi-h-front-porch = <120>;
		qcom,mdss-dsi-h-back-porch = <120>;
		qcom,mdss-dsi-h-pulse-width = <100>;
		qcom,mdss-dsi-h-sync-skew = <0>;
		qcom,mdss-dsi-v-back-porch = <40>;
		qcom,mdss-dsi-v-front-porch = <40>;
		qcom,mdss-dsi-v-pulse-width = <40>;
		qcom,mdss-dsi-h-left-border = <0>;
		qcom,mdss-dsi-h-right-border = <0>;
		qcom,mdss-dsi-v-top-border = <0>;
		qcom,mdss-dsi-v-bottom-border = <0>;
		qcom,mdss-pan-physical-width-dimension = <68>;
		qcom,mdss-pan-physical-height-dimension = <121>;
		qcom,mdss-dsi-bpp = <24>;
		qcom,mdss-dsi-color-order = "rgb_swap_rgb";
		qcom,mdss-dsi-underflow-color = <0xff>;
		qcom,mdss-dsi-border-color = <0>;
		qcom,mdss-dsi-h-sync-pulse = <1>;
/* [PLATFORM]-Mod-BEGIN by TCTNB.WPL, task-2822877, porting from 2467049, 2016/08/31, from qualcomm case 02531526 advice */
		qcom,mdss-dsi-traffic-mode = "non_burst_sync_event";
/* [PLATFORM]-Mod-END by TCTNB.WPL, 2016/08/31 */
		qcom,mdss-dsi-bllp-eof-power-mode;
		qcom,mdss-dsi-bllp-power-mode;
		qcom,mdss-dsi-lane-0-state;
		qcom,mdss-dsi-lane-1-state;
		qcom,mdss-dsi-lane-2-state;
		qcom,mdss-dsi-lane-3-state;
		qcom,mdss-dsi-panel-timings = [22 40 2a 01 74 78 30 44 35 03 04 00];
/* [BUGFIX]-Mod-BEGIN by TCTNB.WPL, 2016/05/28, PR-2219592, update mipi timing */
		qcom,mdss-dsi-panel-timings-8996 = [25 20 09 0a 06 03 04 a0
					25 20 09 0a 06 03 04 a0
					25 20 09 0a 06 03 04 a0
					25 20 09 0a 06 03 04 a0
					25 1e 09 0a 06 03 04 a0];
		qcom,mdss-dsi-reset-sequence = <1 10>, <0 10>, <1 10>;
		qcom,mdss-dsi-t-clk-post = <0x0E>;
		qcom,mdss-dsi-t-clk-pre = <0x35>;
/* [BUGFIX]-Mod-END by TCTNB.WPL, 2016/05/28 */
// start:BBRY_ANDROID
/*
		qcom,mdss-dsi-bl-min-level = <4>;
*/
		qcom,mdss-dsi-bl-min-level = <1>;      //BBRY: change from 4 to 1 to allow full range
// end:BBRY_ANDROID
		qcom,mdss-dsi-bl-max-level = <255>;
		qcom,mdss-dsi-dma-trigger = "trigger_sw";
		qcom,mdss-dsi-mdp-trigger = "none";
		qcom,mdss-dsi-te-pin-select = <1>;
		qcom,mdss-dsi-wr-mem-start = <0x2c>;
		qcom,mdss-dsi-wr-mem-continue = <0x3c>;
		qcom,mdss-dsi-te-dcs-command = <1>;
/* [BUGFIX]-Mod-BEGIN by TCTNB.CY, task-1220822, 2016/01/08, enable HW TE*/
		qcom,mdss-dsi-te-check-enable;
		qcom,mdss-dsi-te-using-te-pin;
/* [BUGFIX]-Mod-END by TCTNB.CY, 2016/01/08*/
//		qcom,ulps-enabled;
		qcom,mdss-dsi-on-command = [
			05 01 00 00 0a 00 02 11 00
			15 01 00 00 00 00 02 35 00		//TE on
			//interface setting
			39 01 00 00 00 00 03 f0 5a 5a
			39 01 00 00 00 00 02 c4 03
			39 01 00 00 00 00 02 f9 03
			39 01 00 00 00 00 14 c2 00 00 d8 d8 00 80 2b 05
								08 0e 07 0b 05 0d 0a 15
								13 20 1e
			39 01 00 00 96 00 03 f0 a5 a5
			//common setting
			39 01 00 00 00 00 03 f0 5a 5a
			39 01 00 00 00 00 02 ed 4d
/* [BUGFIX]-Mod-BEGIN by TCTNB.CY, task-929771, 2015/11/17, enable hsync for tp*/
			39 01 00 00 00 00 03 bc 11 11
/* [BUGFIX]-Mod-END by TCTNB.CY, 2015/11/17*/
			39 01 00 00 00 00 03 f0 a5 a5
			//brightness setting
			15 01 00 00 00 00 02 53 20
			15 01 00 00 00 00 02 51 00		/* [BUGFIX]-Mod-by TCTNB.CY, task-978208, 2015/11/24, set default brightness to 0*/
			15 01 00 00 00 00 02 55 02		//ACL on, Mode 2

			05 01 00 00 00 00 02 2c 00
			05 01 00 00 00 00 02 29 00];

		qcom,mdss-dsi-off-command = [
			05 01 00 00 32 00 02 28 00
			05 01 00 00 78 00 02 10 00];

		qcom,mdss-dsi-on-command-state = "dsi_hs_mode";		/* [BUGFIX]-Mod by TCTNB.CY, FR-989087, 2015/11/27, change send cmd mode to hs mode*/
		qcom,mdss-dsi-off-command-state = "dsi_hs_mode";
		qcom,mdss-dsi-bl-pmic-control-type = "bl_ctrl_dcs";
		qcom,mdss-dsi-lp11-init;
		qcom,dcs-cmd-by-left;
		qcom,panel-supply-entries = <&dsi_panel_pwr_supply_no_labibb>;

               /* Values provided by Display Hardware team, specific to this
                 * panel used for color correction.
                 * The first 4 values should be white (R,B and G=255), red (R=255,
                 * G and B=0), green (G=255, R and B=0) and blue (B=255, R and
                 * G=0), in that order. The x,y and Y values are measured by the
                 * Display HW team and are multiplied by 10000 to covert them to
                 * integers.  They are converted back to floating point when used
                 * in color management calculations.
                 *                                R    G    B    x       y     Y */
		oem,mdss-dsi-bbry-color-points = <255  255  255  3103    3284  3531227>,
                                         <255  0    0    6616    3377  984565>,
                                         <0    255  0    2301    7106  2341208>,
                                         <0    0    255  1430    452   205455>,
                                         <87   108  67   3262    4518  456942>,
                                         <103  189  170  2324    3607  1429543>,
                                         <133  128  177  2658    2435  841100>,
                                         <194  150  130  3941    3597  1314740>,
                                         <8    133  161  1714    2599  634335>,
                                         <231  199  31   4646    5003  2150972>,
                                         <80   91   166  2062    1710  399384>;
	};
/* [PLATFORM]-Mod-BEGIN by TCTNB.CY, FR-764135, 2015/10/20, add panel node for pmi8952 amoled power supply*/
	dsi_dual_s6e3ha3_amoled_pmic_cmd: qcom,mdss_dsi_s6e3ha3_amoled_wqhd_pmic_cmd{
/*[BUGFIX]-Mod-BEGIN by TCTNB.CY, FR-904888, 2015/11/13, modify panel name string for xml file*/
		qcom,mdss-dsi-panel-name =
			"Dual s6e3ha3 amoled cmd mode dsi panel without DSC powered by pmi8994";
/* [BUGFIX]-Mod-END by TCTNB.CY, 2015/11/13*/
		qcom,mdss-dsi-panel-controller = <&mdss_dsi0>;
		qcom,mdss-dsi-panel-type = "dsi_cmd_mode";
		qcom,mdss-dsi-panel-destination = "display_1";
		qcom,mdss-dsi-panel-framerate = <60>;
		qcom,mdss-dsi-virtual-channel-id = <0>;
		qcom,mdss-dsi-stream = <0>;
		qcom,mdss-dsi-panel-width = <720>;
		qcom,mdss-dsi-panel-height = <2560>;
		qcom,mdss-dsi-h-front-porch = <120>;
		qcom,mdss-dsi-h-back-porch = <120>;
		qcom,mdss-dsi-h-pulse-width = <100>;
		qcom,mdss-dsi-h-sync-skew = <0>;
		qcom,mdss-dsi-v-back-porch = <40>;
		qcom,mdss-dsi-v-front-porch = <40>;
		qcom,mdss-dsi-v-pulse-width = <40>;
		qcom,mdss-dsi-h-left-border = <0>;
		qcom,mdss-dsi-h-right-border = <0>;
		qcom,mdss-dsi-v-top-border = <0>;
		qcom,mdss-dsi-v-bottom-border = <0>;
		qcom,mdss-pan-physical-width-dimension = <68>;
		qcom,mdss-pan-physical-height-dimension = <121>;
		qcom,mdss-dsi-bpp = <24>;
		qcom,mdss-dsi-color-order = "rgb_swap_rgb";
		qcom,mdss-dsi-underflow-color = <0xff>;
		qcom,mdss-dsi-border-color = <0>;
		qcom,mdss-dsi-h-sync-pulse = <1>;
/* [PLATFORM]-Mod-BEGIN by TCTNB.WPL, task-2822877, porting from 2467049, 2016/08/31, from qualcomm case 02531526 advice */
		qcom,mdss-dsi-traffic-mode = "non_burst_sync_event";
/* [PLATFORM]-Mod-END by TCTNB.WPL, 2016/08/31 */
		qcom,mdss-dsi-bllp-eof-power-mode;
		qcom,mdss-dsi-bllp-power-mode;
		qcom,mdss-dsi-lane-0-state;
		qcom,mdss-dsi-lane-1-state;
		qcom,mdss-dsi-lane-2-state;
		qcom,mdss-dsi-lane-3-state;
		qcom,mdss-dsi-panel-timings = [22 40 2a 01 74 78 30 44 35 03 04 00];
/* [BUGFIX]-Mod-BEGIN by TCTNB.WPL, 2016/05/28, PR-2219592, update mipi timing */
		qcom,mdss-dsi-panel-timings-8996 = [25 20 09 0a 06 03 04 a0
					25 20 09 0a 06 03 04 a0
					25 20 09 0a 06 03 04 a0
					25 20 09 0a 06 03 04 a0
					25 1e 09 0a 06 03 04 a0];
		qcom,mdss-dsi-reset-sequence = <1 10>, <0 10>, <1 10>;
		qcom,mdss-dsi-t-clk-post = <0x0E>;
		qcom,mdss-dsi-t-clk-pre = <0x35>;
/* [BUGFIX]-Mod-END by TCTNB.WPL, 2016/05/28 */
// start:BBRY_ANDROID
/*
		qcom,mdss-dsi-bl-min-level = <4>;
*/
		qcom,mdss-dsi-bl-min-level = <1>;      //BBRY: change from 4 to 1 to allow full range
// end:BBRY_ANDROID
		qcom,mdss-dsi-bl-max-level = <255>;
		qcom,mdss-dsi-dma-trigger = "trigger_sw";
		qcom,mdss-dsi-mdp-trigger = "none";
		qcom,mdss-dsi-te-pin-select = <1>;
		qcom,mdss-dsi-wr-mem-start = <0x2c>;
		qcom,mdss-dsi-wr-mem-continue = <0x3c>;
		qcom,mdss-dsi-te-dcs-command = <1>;
/* [BUGFIX]-Mod-BEGIN by TCTNB.CY, task-1220822, 2016/01/08, enable HW TE*/
		qcom,mdss-dsi-te-check-enable;
		qcom,mdss-dsi-te-using-te-pin;
/* [BUGFIX]-Mod-END by TCTNB.CY, 2016/01/08*/
//		qcom,ulps-enabled;
		qcom,mdss-dsi-on-command = [
			05 01 00 00 0a 00 02 11 00
			15 01 00 00 00 00 02 35 00		//TE on
			//interface setting
			39 01 00 00 00 00 03 f0 5a 5a
			39 01 00 00 00 00 02 c4 03
			39 01 00 00 00 00 02 f9 03
			39 01 00 00 00 00 14 c2 00 00 d8 d8 00 80 2b 05
								08 0e 07 0b 05 0d 0a 15
								13 20 1e
			39 01 00 00 96 00 03 f0 a5 a5
			//common setting
			39 01 00 00 00 00 03 f0 5a 5a
			39 01 00 00 00 00 02 ed 4d
/* [BUGFIX]-Mod-BEGIN by TCTNB.CY, task-929771, 2015/11/17, enable hsync for tp*/
			39 01 00 00 00 00 03 bc 11 11
/* [BUGFIX]-Mod-END by TCTNB.CY, 2015/11/17*/
			39 01 00 00 00 00 03 f0 a5 a5
			//brightness setting
			15 01 00 00 00 00 02 53 20
			15 01 00 00 00 00 02 51 00		/* [BUGFIX]-Mod-by TCTNB.CY, task-978208, 2015/11/24, set default brightness to 0*/
			15 01 00 00 00 00 02 55 02		//ACL on, Mode 2
			
			05 01 00 00 00 00 02 2c 00
			05 01 00 00 00 00 02 29 00];

		qcom,mdss-dsi-off-command = [
			05 01 00 00 32 00 02 28 00
			05 01 00 00 78 00 02 10 00];

		qcom,mdss-dsi-on-command-state = "dsi_hs_mode";	/* [BUGFIX]-Mod by TCTNB.CY, FR-989087, 2015/11/27, change send cmd mode to hs mode*/
		qcom,mdss-dsi-off-command-state = "dsi_hs_mode";
		qcom,mdss-dsi-bl-pmic-control-type = "bl_ctrl_dcs";
		qcom,mdss-dsi-lp11-init;
		qcom,dcs-cmd-by-left;
		qcom,panel-supply-entries = <&dsi_panel_pwr_supply_pmi8994>;

               /* Values provided by Display Hardware team, specific to this
                 * panel used for color correction.
                 * The first 4 values should be white (R,B and G=255), red (R=255,
                 * G and B=0), green (G=255, R and B=0) and blue (B=255, R and
                 * G=0), in that order. The x,y and Y values are measured by the
                 * Display HW team and are multiplied by 10000 to covert them to
                 * integers.  They are converted back to floating point when used
                 * in color management calculations.
                 *                                R    G    B    x       y     Y */
		oem,mdss-dsi-bbry-color-points = <255  255  255  3103    3284  3531227>,
                                         <255  0    0    6616    3377  984565>,
                                         <0    255  0    2301    7106  2341208>,
                                         <0    0    255  1430    452   205455>,
                                         <87   108  67   3262    4518  456942>,
                                         <103  189  170  2324    3607  1429543>,
                                         <133  128  177  2658    2435  841100>,
                                         <194  150  130  3941    3597  1314740>,
                                         <8    133  161  1714    2599  634335>,
                                         <231  199  31   4646    5003  2150972>,
                                         <80   91   166  2062    1710  399384>;
/* [BUGFIX]-Mod-BEGIN by TCTNB.WPL, 2016/08/19, PR-2751666, panel ESD */
		qcom,esd-check-enabled;
		qcom,mdss-dsi-panel-status-command = [06 01 00 01 05 00 02 0A 00];
		qcom,mdss-dsi-panel-status-command-state = "dsi_lp_mode";
		qcom,mdss-dsi-panel-status-check-mode = "reg_read";
		qcom,mdss-dsi-panel-status-read-length = <1>;
		qcom,mdss-dsi-panel-max-error-count = <0>;
/* start BBRY: add mask to status value to avoid spurius recoveries */
		qcom,mdss-dsi-panel-status-value = <0x14>;
		oem,mdss-dsi-panel-status-value-mask = <0x14>;
/* end BBRY */
/* [BUGFIX]-Mod-END by TCTNB.WPL, 2016/08/19 */
	};
/* [PLATFORM]-Mod-END by TCTNB.CY, 2015/10/20*/

/* [PLATFORM]-Mod-BEGIN by TCTNB.CY, FR-1192236, 2015/12/18, disable  HW TE if panel not connected*/
	dsi_dual_s6e3ha3_amoled_sw_te: qcom,mdss_dsi_s6e3ha3_amoled_wqhd_sw_te{
		qcom,mdss-dsi-panel-name =
			"Dual s6e3ha3 amoled cmd mode dsi panel without DSC with sw te";
		qcom,mdss-dsi-panel-controller = <&mdss_dsi0>;
		qcom,mdss-dsi-panel-type = "dsi_cmd_mode";
		qcom,mdss-dsi-panel-destination = "display_1";
		qcom,mdss-dsi-panel-framerate = <60>;
		qcom,mdss-dsi-virtual-channel-id = <0>;
		qcom,mdss-dsi-stream = <0>;
		qcom,mdss-dsi-panel-width = <720>;
		qcom,mdss-dsi-panel-height = <2560>;
		qcom,mdss-dsi-h-front-porch = <120>;
		qcom,mdss-dsi-h-back-porch = <120>;
		qcom,mdss-dsi-h-pulse-width = <100>;
		qcom,mdss-dsi-h-sync-skew = <0>;
		qcom,mdss-dsi-v-back-porch = <40>;
		qcom,mdss-dsi-v-front-porch = <40>;
		qcom,mdss-dsi-v-pulse-width = <40>;
		qcom,mdss-dsi-h-left-border = <0>;
		qcom,mdss-dsi-h-right-border = <0>;
		qcom,mdss-dsi-v-top-border = <0>;
		qcom,mdss-dsi-v-bottom-border = <0>;
		qcom,mdss-pan-physical-width-dimension = <68>;
		qcom,mdss-pan-physical-height-dimension = <121>;
		qcom,mdss-dsi-bpp = <24>;
		qcom,mdss-dsi-color-order = "rgb_swap_rgb";
		qcom,mdss-dsi-underflow-color = <0xff>;
		qcom,mdss-dsi-border-color = <0>;
		qcom,mdss-dsi-h-sync-pulse = <1>;
/* [PLATFORM]-Mod-BEGIN by TCTNB.WPL, task-2822877, porting from 2467049, 2016/08/31, from qualcomm case 02531526 advice */
		qcom,mdss-dsi-traffic-mode = "non_burst_sync_event";
/* [PLATFORM]-Mod-END by TCTNB.WPL, 2016/08/31 */
		qcom,mdss-dsi-bllp-eof-power-mode;
		qcom,mdss-dsi-bllp-power-mode;
		qcom,mdss-dsi-lane-0-state;
		qcom,mdss-dsi-lane-1-state;
		qcom,mdss-dsi-lane-2-state;
		qcom,mdss-dsi-lane-3-state;
		qcom,mdss-dsi-panel-timings = [22 40 2a 01 74 78 30 44 35 03 04 00];
/* [BUGFIX]-Mod-BEGIN by TCTNB.WPL, 2016/05/28, PR-2219592, update mipi timing */
		qcom,mdss-dsi-panel-timings-8996 = [25 20 09 0a 06 03 04 a0
					25 20 09 0a 06 03 04 a0
					25 20 09 0a 06 03 04 a0
					25 20 09 0a 06 03 04 a0
					25 1e 09 0a 06 03 04 a0];
		qcom,mdss-dsi-reset-sequence = <1 10>, <0 10>, <1 10>;
		qcom,mdss-dsi-t-clk-post = <0x0E>;
		qcom,mdss-dsi-t-clk-pre = <0x35>;
/* [BUGFIX]-Mod-END by TCTNB.WPL, 2016/05/28 */
// start:BBRY_ANDROID
/*
		qcom,mdss-dsi-bl-min-level = <4>;
*/
		qcom,mdss-dsi-bl-min-level = <1>;      //BBRY: change from 4 to 1 to allow full range
// end:BBRY_ANDROID
		qcom,mdss-dsi-bl-max-level = <255>;
		qcom,mdss-dsi-dma-trigger = "trigger_sw";
		qcom,mdss-dsi-mdp-trigger = "none";
		qcom,mdss-dsi-te-pin-select = <1>;
		qcom,mdss-dsi-wr-mem-start = <0x2c>;
		qcom,mdss-dsi-wr-mem-continue = <0x3c>;
		qcom,mdss-dsi-te-dcs-command = <1>;
		qcom,mdss-tear-check-disable;
		//sw TE signal
		qcom,mdss-tear-check-frame-rate = <6000>; // 60fps
		qcom,mdss-tear-check-sync-cfg-height = <2900>;
		qcom,mdss-tear-check-rd-ptr-trigger-intr= <2653>;
		qcom,mdss-tear-check-start-pos= <2654>;
//		qcom,ulps-enabled;
		qcom,mdss-dsi-on-command = [
			05 01 00 00 0a 00 02 11 00
			15 01 00 00 00 00 02 35 00
			//interface setting
			39 01 00 00 00 00 03 f0 5a 5a
			39 01 00 00 00 00 02 c4 03
			39 01 00 00 00 00 02 f9 03
			39 01 00 00 00 00 14 c2 00 00 d8 d8 00 80 2b 05
								08 0e 07 0b 05 0d 0a 15
								13 20 1e
			39 01 00 00 96 00 03 f0 a5 a5
			//common setting
			39 01 00 00 00 00 03 f0 5a 5a
			39 01 00 00 00 00 02 ed 4d
			39 01 00 00 00 00 03 bc 11 11
			39 01 00 00 00 00 03 f0 a5 a5
			//brightness setting
			15 01 00 00 00 00 02 53 20
			15 01 00 00 00 00 02 51 00
			15 01 00 00 00 00 02 55 02		//ACL on, Mode 2

			05 01 00 00 00 00 02 2c 00
			05 01 00 00 00 00 02 29 00];

		qcom,mdss-dsi-off-command = [
			05 01 00 00 32 00 02 28 00
			05 01 00 00 78 00 02 10 00];

		qcom,mdss-dsi-on-command-state = "dsi_hs_mode";
		qcom,mdss-dsi-off-command-state = "dsi_hs_mode";
		qcom,mdss-dsi-bl-pmic-control-type = "bl_ctrl_dcs";
		qcom,mdss-dsi-lp11-init;
		qcom,dcs-cmd-by-left;
		qcom,panel-supply-entries = <&dsi_panel_pwr_supply_pmi8994>;

               /* Values provided by Display Hardware team, specific to this
                 * panel used for color correction.
                 * The first 4 values should be white (R,B and G=255), red (R=255,
                 * G and B=0), green (G=255, R and B=0) and blue (B=255, R and
                 * G=0), in that order. The x,y and Y values are measured by the
                 * Display HW team and are multiplied by 10000 to covert them to
                 * integers.  They are converted back to floating point when used
                 * in color management calculations.
                 *                                R    G    B    x       y     Y */
		oem,mdss-dsi-bbry-color-points = <255  255  255  3103    3284  3531227>,
                                         <255  0    0    6616    3377  984565>,
                                         <0    255  0    2301    7106  2341208>,
                                         <0    0    255  1430    452   205455>,
                                         <87   108  67   3262    4518  456942>,
                                         <103  189  170  2324    3607  1429543>,
                                         <133  128  177  2658    2435  841100>,
                                         <194  150  130  3941    3597  1314740>,
                                         <8    133  161  1714    2599  634335>,
                                         <231  199  31   4646    5003  2150972>,
                                         <80   91   166  2062    1710  399384>;
	};
/* [PLATFORM]-Mod-END by TCTNB.CY, 2015/12/18*/

};
