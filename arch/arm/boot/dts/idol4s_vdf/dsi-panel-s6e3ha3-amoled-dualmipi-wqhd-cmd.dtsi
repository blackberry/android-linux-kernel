/* Copyright (c) 2015, The Linux Foundation. All rights reserved.
 *
 * This program is free software; you can redistribute it and/or modify
 * it under the terms of the GNU General Public License version 2 and
 * only version 2 as published by the Free Software Foundation.
 *
 * This program is distributed in the hope that it will be useful,
 * but WITHOUT ANY WARRANTY; without even the implied warranty of
 * MERCHANTABILITY or FITNESS FOR A PARTICULAR PURPOSE.  See the
 * GNU General Public License for more details.
 */

&mdss_mdp {
	dsi_dual_s6e3ha3_amoled_cmd: qcom,mdss_dsi_s6e3ha3_amoled_wqhd_cmd{
		qcom,mdss-dsi-panel-name =
			"Dual s6e3ha3 amoled cmd mode dsi panel without DSC";
		qcom,mdss-dsi-panel-controller = <&mdss_dsi0>;
		qcom,mdss-dsi-panel-type = "dsi_cmd_mode";
		qcom,mdss-dsi-panel-destination = "display_1";
		qcom,mdss-dsi-panel-framerate = <60>;
		qcom,mdss-dsi-virtual-channel-id = <0>;
		qcom,mdss-dsi-stream = <0>;
		qcom,mdss-dsi-panel-width = <720>;
		qcom,mdss-dsi-panel-height = <2560>;
		qcom,mdss-dsi-h-front-porch = <120>;
		qcom,mdss-dsi-h-back-porch = <120>;
		qcom,mdss-dsi-h-pulse-width = <100>;
		qcom,mdss-dsi-h-sync-skew = <0>;
		qcom,mdss-dsi-v-back-porch = <40>;
		qcom,mdss-dsi-v-front-porch = <40>;
		qcom,mdss-dsi-v-pulse-width = <40>;
		qcom,mdss-dsi-h-left-border = <0>;
		qcom,mdss-dsi-h-right-border = <0>;
		qcom,mdss-dsi-v-top-border = <0>;
		qcom,mdss-dsi-v-bottom-border = <0>;
		qcom,mdss-pan-physical-width-dimension = <68>;
		qcom,mdss-pan-physical-height-dimension = <121>;
		qcom,mdss-dsi-bpp = <24>;
		qcom,mdss-dsi-color-order = "rgb_swap_rgb";
		qcom,mdss-dsi-underflow-color = <0xff>;
		qcom,mdss-dsi-border-color = <0>;
		qcom,mdss-dsi-h-sync-pulse = <1>;
		qcom,mdss-dsi-traffic-mode = "burst_mode";//"non_burst_sync_event";
		qcom,mdss-dsi-bllp-eof-power-mode;
		qcom,mdss-dsi-bllp-power-mode;
		qcom,mdss-dsi-lane-0-state;
		qcom,mdss-dsi-lane-1-state;
		qcom,mdss-dsi-lane-2-state;
		qcom,mdss-dsi-lane-3-state;
/* [BUGFIX]-Mod-BEGIN by TCTCD-Jinlin.Hu, defect-1176517, 2015/12/17, optimize dsi clk configure*/
                qcom,mdss-dsi-panel-timings = [22 40 2a 01 74 78 30 44 35 03 04 00];
                qcom,mdss-dsi-reset-sequence = <1 10>, <0 10>, <1 10>;
                qcom,mdss-dsi-t-clk-post = <0x02>;
                qcom,mdss-dsi-t-clk-pre = <0x33>;
/* [BUGFIX]-Mod-END by TCTCD-Jinlin.Hu, 2015/12/17*/
		qcom,mdss-dsi-bl-min-level = <4>;
		qcom,mdss-dsi-bl-max-level = <255>;
		qcom,mdss-dsi-dma-trigger = "trigger_sw";
		qcom,mdss-dsi-mdp-trigger = "none";
		qcom,mdss-dsi-te-pin-select = <1>;
		qcom,mdss-dsi-wr-mem-start = <0x2c>;
		qcom,mdss-dsi-wr-mem-continue = <0x3c>;
		qcom,mdss-dsi-te-dcs-command = <1>;
//		qcom,mdss-tear-check-disable;
		qcom,mdss-dsi-te-check-enable;
		qcom,mdss-dsi-te-using-te-pin;
//		qcom,ulps-enabled;
		qcom,mdss-dsi-on-command = [
			05 01 00 00 0a 00 02 11 00
			15 01 00 00 00 00 02 35 00		//TE on
			//interface setting
			39 01 00 00 00 00 03 f0 5a 5a
			39 01 00 00 00 00 02 c4 03
			39 01 00 00 00 00 02 f9 03
			39 01 00 00 00 00 14 c2 00 00 d8 d8 00 80 2b 05
								08 0e 07 0b 05 0d 0a 15
								13 20 1e
			39 01 00 00 96 00 03 f0 a5 a5
			//common setting
			39 01 00 00 00 00 03 f0 5a 5a
			39 01 00 00 00 00 02 ed 4d
/* [BUGFIX]-Mod-BEGIN by TCTCD-Jinlin.Hu, defect-978469, 2015/11/24, enable hsync for tp*/
                        39 01 00 00 00 00 03 bc 11 11
/* [BUGFIX]-Mod-END by TCTCD-Jinlin.Hu, 2015/11/24*/
			39 01 00 00 00 00 03 f0 a5 a5
			//brightness setting
			15 01 00 00 00 00 02 53 20              /* [BUGFIX]-Mod-by TCTCD-Jinlin.Hu, defect-981909, 2015/12/9, brightness blink*/
			15 01 00 00 00 00 02 51 00              /* [BUGFIX]-Mod-by TCTCD-Jinlin.Hu, defect-1103864, 2015/12/9, set default brightness to 0*/
			15 01 00 00 00 00 02 55 00		//ACL off
			
			05 01 00 00 00 00 02 2c 00
			05 01 00 00 00 00 02 29 00];

		qcom,mdss-dsi-off-command = [
			05 01 00 00 32 00 02 28 00
			05 01 00 00 78 00 02 10 00];

		qcom,mdss-dsi-on-command-state = "dsi_hs_mode";
		qcom,mdss-dsi-off-command-state = "dsi_hs_mode";
		qcom,mdss-dsi-bl-pmic-control-type = "bl_ctrl_dcs";
		qcom,mdss-dsi-lp11-init;
/* [BUGFIX]-Mod-BEGIN by TCTCD-Jinlin.Hu, defect-1176517, 2015/12/17, modify for timeout warning*/
//                qcom,mdss-tear-check-sync-cfg-height = <2900>;
/* [BUGFIX]-Mod-END by TCTCD-Jinlin.Hu, 2015/12/17*/
		qcom,dcs-cmd-by-left;
	};
/* [PLATFORM]-Mod-BEGIN by TCTCD-Jinlin.Hu, FR-803509, 2015/10/27, add panel node for pmi8952 amoled power supply*/
	dsi_dual_s6e3ha3_amoled_pmic_cmd: qcom,mdss_dsi_s6e3ha3_amoled_wqhd_pmic_cmd{
		qcom,mdss-dsi-panel-name =
			"Dual s6e3ha3 amoled cmd mode dsi panel without DSC powered by pmi8952";
		qcom,mdss-dsi-panel-controller = <&mdss_dsi0>;
		qcom,mdss-dsi-panel-type = "dsi_cmd_mode";
		qcom,mdss-dsi-panel-destination = "display_1";
		qcom,mdss-dsi-panel-framerate = <60>;
		qcom,mdss-dsi-virtual-channel-id = <0>;
		qcom,mdss-dsi-stream = <0>;
		qcom,mdss-dsi-panel-width = <720>;
		qcom,mdss-dsi-panel-height = <2560>;
		qcom,mdss-dsi-h-front-porch = <120>;
		qcom,mdss-dsi-h-back-porch = <120>;
		qcom,mdss-dsi-h-pulse-width = <100>;
		qcom,mdss-dsi-h-sync-skew = <0>;
		qcom,mdss-dsi-v-back-porch = <40>;
		qcom,mdss-dsi-v-front-porch = <40>;
		qcom,mdss-dsi-v-pulse-width = <40>;
		qcom,mdss-dsi-h-left-border = <0>;
		qcom,mdss-dsi-h-right-border = <0>;
		qcom,mdss-dsi-v-top-border = <0>;
		qcom,mdss-dsi-v-bottom-border = <0>;
		qcom,mdss-pan-physical-width-dimension = <68>;
		qcom,mdss-pan-physical-height-dimension = <121>;
		qcom,mdss-dsi-bpp = <24>;
		qcom,mdss-dsi-color-order = "rgb_swap_rgb";
		qcom,mdss-dsi-underflow-color = <0xff>;
		qcom,mdss-dsi-border-color = <0>;
		qcom,mdss-dsi-h-sync-pulse = <1>;
		qcom,mdss-dsi-traffic-mode = "burst_mode";//"non_burst_sync_event";
		qcom,mdss-dsi-bllp-eof-power-mode;
		qcom,mdss-dsi-bllp-power-mode;
		qcom,mdss-dsi-lane-0-state;
		qcom,mdss-dsi-lane-1-state;
		qcom,mdss-dsi-lane-2-state;
		qcom,mdss-dsi-lane-3-state;
/* [BUGFIX]-Mod-BEGIN by TCTCD-Jinlin.Hu, defect-1176517, 2015/12/17, optimize dsi clk configure*/
                qcom,mdss-dsi-panel-timings = [22 40 2a 01 74 78 30 44 35 03 04 00];
                qcom,mdss-dsi-reset-sequence = <1 10>, <0 10>, <1 10>;
                qcom,mdss-dsi-t-clk-post = <0x02>;
                qcom,mdss-dsi-t-clk-pre = <0x33>;
/* [BUGFIX]-Mod-END by TCTCD-Jinlin.Hu, 2015/12/17*/
		qcom,mdss-dsi-bl-min-level = <4>;
		qcom,mdss-dsi-bl-max-level = <255>;
		qcom,mdss-dsi-dma-trigger = "trigger_sw";
		qcom,mdss-dsi-mdp-trigger = "none";
		qcom,mdss-dsi-te-pin-select = <1>;
		qcom,mdss-dsi-wr-mem-start = <0x2c>;
		qcom,mdss-dsi-wr-mem-continue = <0x3c>;
		qcom,mdss-dsi-te-dcs-command = <1>;
//		qcom,mdss-tear-check-disable;
		qcom,mdss-dsi-te-check-enable;
		qcom,mdss-dsi-te-using-te-pin;
//		qcom,ulps-enabled;
		qcom,mdss-dsi-on-command = [
			05 01 00 00 0a 00 02 11 00
			15 01 00 00 00 00 02 35 00		//TE on
			//interface setting
			39 01 00 00 00 00 03 f0 5a 5a
			39 01 00 00 00 00 02 c4 03
			39 01 00 00 00 00 02 f9 03
			39 01 00 00 00 00 14 c2 00 00 d8 d8 00 80 2b 05
								08 0e 07 0b 05 0d 0a 15
								13 20 1e
			39 01 00 00 96 00 03 f0 a5 a5
			//common setting
			39 01 00 00 00 00 03 f0 5a 5a
			39 01 00 00 00 00 02 ed 4d
/* [BUGFIX]-Mod-BEGIN by TCTCD-Jinlin.Hu, defect-978469, 2015/11/24, enable hsync for tp*/
                        39 01 00 00 00 00 03 bc 11 11
/* [BUGFIX]-Mod-END by TCTCD-Jinlin.Hu, 2015/11/24*/
			39 01 00 00 00 00 03 f0 a5 a5
			//brightness setting
			15 01 00 00 00 00 02 53 20              /* [BUGFIX]-Mod-by TCTCD-Jinlin.Hu, defect-981909, 2015/12/9, brightness blink*/
			15 01 00 00 00 00 02 51 00		/* [BUGFIX]-Mod-by TCTCD-Jinlin.Hu, defect-1103864, 2015/12/9, set default brightness to 0*/
			15 01 00 00 00 00 02 55 00		//ACL off
			
			05 01 00 00 00 00 02 2c 00
			05 01 00 00 00 00 02 29 00];

		qcom,mdss-dsi-off-command = [
			05 01 00 00 32 00 02 28 00
			05 01 00 00 78 00 02 10 00];

		qcom,mdss-dsi-on-command-state = "dsi_hs_mode";
		qcom,mdss-dsi-off-command-state = "dsi_hs_mode";
		qcom,mdss-dsi-bl-pmic-control-type = "bl_ctrl_dcs";
		qcom,mdss-dsi-lp11-init;
/* [BUGFIX]-Mod-BEGIN by TCTCD-Jinlin.Hu, defect-1176517, 2015/12/17, modify for timeout warning*/
//                qcom,mdss-tear-check-sync-cfg-height = <2900>;
/* [BUGFIX]-Mod-END by TCTCD-Jinlin.Hu, 2015/12/17*/
		qcom,dcs-cmd-by-left;
	};
/* [PLATFORM]-Mod-END by TCTCD-Jinlin.Hu, 2015/10/27*/

/*Add-Begin by song.peng 2016/01/21, follow NB*/
/* [PLATFORM]-Mod-BEGIN by TCTNB.CY, FR-1192236, 2015/12/18, disable  HW TE if panel not connected*/
	dsi_dual_s6e3ha3_amoled_sw_te: qcom,mdss_dsi_s6e3ha3_amoled_wqhd_sw_te{
		qcom,mdss-dsi-panel-name =
			"Dual s6e3ha3 amoled cmd mode dsi panel without DSC with sw te";
		qcom,mdss-dsi-panel-controller = <&mdss_dsi0>;
		qcom,mdss-dsi-panel-type = "dsi_cmd_mode";
		qcom,mdss-dsi-panel-destination = "display_1";
		qcom,mdss-dsi-panel-framerate = <60>;
		qcom,mdss-dsi-virtual-channel-id = <0>;
		qcom,mdss-dsi-stream = <0>;
		qcom,mdss-dsi-panel-width = <720>;
		qcom,mdss-dsi-panel-height = <2560>;
		qcom,mdss-dsi-h-front-porch = <120>;
		qcom,mdss-dsi-h-back-porch = <120>;
		qcom,mdss-dsi-h-pulse-width = <100>;
		qcom,mdss-dsi-h-sync-skew = <0>;
		qcom,mdss-dsi-v-back-porch = <40>;
		qcom,mdss-dsi-v-front-porch = <40>;
		qcom,mdss-dsi-v-pulse-width = <40>;
		qcom,mdss-dsi-h-left-border = <0>;
		qcom,mdss-dsi-h-right-border = <0>;
		qcom,mdss-dsi-v-top-border = <0>;
		qcom,mdss-dsi-v-bottom-border = <0>;
		qcom,mdss-pan-physical-width-dimension = <68>;
		qcom,mdss-pan-physical-height-dimension = <121>;
		qcom,mdss-dsi-bpp = <24>;
		qcom,mdss-dsi-color-order = "rgb_swap_rgb";
		qcom,mdss-dsi-underflow-color = <0xff>;
		qcom,mdss-dsi-border-color = <0>;
		qcom,mdss-dsi-h-sync-pulse = <1>;
		qcom,mdss-dsi-traffic-mode = "burst_mode";
		qcom,mdss-dsi-bllp-eof-power-mode;
		qcom,mdss-dsi-bllp-power-mode;
		qcom,mdss-dsi-lane-0-state;
		qcom,mdss-dsi-lane-1-state;
		qcom,mdss-dsi-lane-2-state;
		qcom,mdss-dsi-lane-3-state;
		qcom,mdss-dsi-panel-timings = [22 40 2a 01 74 78 30 44 35 03 04 00];
		qcom,mdss-dsi-reset-sequence = <1 10>, <0 10>, <1 10>;
		qcom,mdss-dsi-t-clk-post = <0x02>;
		qcom,mdss-dsi-t-clk-pre = <0x33>;
		qcom,mdss-dsi-bl-min-level = <4>;
		qcom,mdss-dsi-bl-max-level = <255>;
		qcom,mdss-dsi-dma-trigger = "trigger_sw";
		qcom,mdss-dsi-mdp-trigger = "none";
		qcom,mdss-dsi-te-pin-select = <1>;
		qcom,mdss-dsi-wr-mem-start = <0x2c>;
		qcom,mdss-dsi-wr-mem-continue = <0x3c>;
		qcom,mdss-dsi-te-dcs-command = <1>;
		qcom,mdss-tear-check-disable;
		//sw TE signal
		qcom,mdss-tear-check-frame-rate = <6000>; // 60fps
		qcom,mdss-tear-check-sync-cfg-height = <2900>;
		qcom,mdss-tear-check-rd-ptr-trigger-intr= <2653>;
		qcom,mdss-tear-check-start-pos= <2654>;
//		qcom,ulps-enabled;
		qcom,mdss-dsi-on-command = [
			05 01 00 00 0a 00 02 11 00
			15 01 00 00 00 00 02 35 00
			//interface setting
			39 01 00 00 00 00 03 f0 5a 5a
			39 01 00 00 00 00 02 c4 03
			39 01 00 00 00 00 02 f9 03
			39 01 00 00 00 00 14 c2 00 00 d8 d8 00 80 2b 05
								08 0e 07 0b 05 0d 0a 15
								13 20 1e
			39 01 00 00 96 00 03 f0 a5 a5
			//common setting
			39 01 00 00 00 00 03 f0 5a 5a
			39 01 00 00 00 00 02 ed 4d
			39 01 00 00 00 00 03 bc 11 11
			39 01 00 00 00 00 03 f0 a5 a5
			//brightness setting
			15 01 00 00 00 00 02 53 20
			15 01 00 00 00 00 02 51 00
			15 01 00 00 00 00 02 55 00		//ACL off

			05 01 00 00 00 00 02 2c 00
			05 01 00 00 00 00 02 29 00];

		qcom,mdss-dsi-off-command = [
			05 01 00 00 32 00 02 28 00
			05 01 00 00 78 00 02 10 00];

		qcom,mdss-dsi-on-command-state = "dsi_hs_mode";
		qcom,mdss-dsi-off-command-state = "dsi_hs_mode";
		qcom,mdss-dsi-bl-pmic-control-type = "bl_ctrl_dcs";
		qcom,mdss-dsi-lp11-init;
		qcom,dcs-cmd-by-left;
		qcom,panel-supply-entries = <&dsi_panel_pwr_supply_with_pmi8952>;
	};
/* [PLATFORM]-Mod-END by TCTNB.CY, 2015/12/18*/
/*Add-End by song.peng 2016/01/21, follow NB*/

};
