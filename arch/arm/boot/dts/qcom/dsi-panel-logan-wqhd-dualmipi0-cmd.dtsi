/* Copyright (C) 2014 BlackBerry Limited. All rights reserved.
 * Copyright (c) 2013, The Linux Foundation. All rights reserved.
 *
 * This program is free software; you can redistribute it and/or modify
 * it under the terms of the GNU General Public License version 2 and
 * only version 2 as published by the Free Software Foundation.
 *
 * This program is distributed in the hope that it will be useful,
 * but WITHOUT ANY WARRANTY; without even the implied warranty of
 * MERCHANTABILITY or FITNESS FOR A PARTICULAR PURPOSE.  See the
 * GNU General Public License for more details.
 */

/*---------------------------------------------------------------------------
 * This file is autogenerated file using gcdb parser. Please do not edit it.
 * Update input XML file to add a new entry or update variable in this file
 * VERSION = "1.0"
 *---------------------------------------------------------------------------*/
&mdss_mdp {
	dsi_logan_wqhd_cmd_0: qcom,mdss_dsi_logan_wqhd_dualmipi0_cmd {
		qcom,mdss-dsi-panel-name = "Logan WQHD dual0 cmd mode dsi panel";
		oem,mdss-dsi-bbry-lcd-id-class = <53>; /* Logan */
		oem,mdss-dsi-bbry-lcd-id-mfg = <19>; /* SDC */
		qcom,cont-splash-enabled;
		qcom,mdss-dsi-panel-controller = <&mdss_dsi0>;
		qcom,mdss-dsi-panel-type = "dsi_cmd_mode";
		qcom,mdss-dsi-panel-destination = "display_1";
		qcom,mdss-dsi-panel-framerate = <60>;
		qcom,mdss-dsi-panel-clockrate = <830000000>;
		qcom,mdss-dsi-stream = <0>;
		qcom,mdss-dsi-panel-width = <720>;
		qcom,mdss-dsi-panel-height = <2560>;
		qcom,mdss-pan-physical-width-dimension = <68>;  /* (1440 px / 68mm) * 25.4 mm/inch = 537.9 px/inch */
		qcom,mdss-pan-physical-height-dimension = <121>; /* (2560 px / 121mm) * 25.4 mm/inch = 537.3 px/inch */
		qcom,mdss-dsi-h-front-porch = <30>;
		qcom,mdss-dsi-h-back-porch = <14>;
		qcom,mdss-dsi-h-pulse-width = <10>;
		qcom,mdss-dsi-h-sync-skew = <0>;
		qcom,mdss-dsi-v-back-porch = <1>;
		qcom,mdss-dsi-v-front-porch = <7>;
		qcom,mdss-dsi-v-pulse-width = <8>;
		qcom,mdss-dsi-h-left-border = <0>;
		qcom,mdss-dsi-h-right-border = <0>;
		qcom,mdss-dsi-v-top-border = <0>;
		qcom,mdss-dsi-v-bottom-border = <0>;
		qcom,mdss-dsi-bpp = <24>;
		qcom,mdss-dsi-underflow-color = <0xff>;
		qcom,mdss-dsi-border-color = <0>;
		qcom,mdss-dsi-on-command = [05 01 00 01 05 00 01 11
				39 01 00 00 00 00 03 f0 5a 5a
				39 01 00 00 78 00 02 f2 63
				39 01 00 00 00 00 02 35 00
				39 01 00 00 00 00 02 b4 00
				39 01 00 00 00 00 02 c0 00
				39 01 00 00 00 00 02 55 02
				39 01 00 00 00 00 03 f0 a5 a5];
		oem,mdss-dsi-glass-on-command = [05 01 00 01 0a 00 01 29];
		qcom,mdss-dsi-off-command = [05 01 00 00 78 00 01 10
				05 01 00 00 78 00 01 28];
		qcom,mdss-dsi-on-command-state = "dsi_lp_mode";
		qcom,mdss-dsi-off-command-state = "dsi_hs_mode";
		oem,mdss-dsi-glass-on-command-state = "dsi_hs_mode";
		oem,mdss-dsi-on-recovery-command = [39 01 00 00 00 00 03 f0 5a 5a
				39 01 00 00 00 00 03 f1 5a 5a

				39 01 00 00 78 00 02 f2 63

				39 01 00 00 00 00 02 B0 01
				39 01 00 00 78 00 0a f2 41 C5 06 0A 4C 40 0C 04 94
				39 01 00 00 00 00 09 F4 8B 21 80 58 8B 1F 0C 53
				39 01 00 00 00 00 09 F5 E0 03 0F 1B 8E 58 61 80
				39 01 00 00 00 00 08 F6 43 07 17 01 AA 59 00
				39 01 00 00 00 00 0c B1 00 08 54 20 1A 33 5E 8C B3 D9 FF

				39 01 00 00 00 00 08 b2 03 10 0A 0A 0A 40 40
				39 01 00 00 00 00 25 B4 00 01 26 01 20 01 28 83 84 83 7E 7D 7F 7C 7D 7B 7E 7F 7F 82 84 84 7E 7D 7E 80 7E 80 8B 87 7A 00 00 00 00 00
				39 01 00 00 00 00 0c b5 50 99 27 12 45 55 55 55 4D 96 1D
				39 01 00 00 00 00 18 b6 98 19 00 00 00 00 00 03 55 54 20 80 00 0A AA A4 14 01 22 22 10 0E 21
				39 01 00 00 00 00 09 B8 30 00 00 80 30 00 28 19
				39 01 00 00 00 00 0f BB C0 00 00 00 00 75 65 86 32 28 3E 11 06 06
				39 01 00 00 00 00 0b C7 06 00 00 00 00 00 00 00 00 00
				39 01 00 00 00 00 03 CC 40 51
				39 01 00 00 00 00 52 CB 18 11 81 01 F4 01 66 00 E0 09 00 00 00 00 02 05 00 15 98 15 98 00 00 00 00 01 00 00 00 00 00 12 9E 00 00 C0 01 05 04 42 03 D1 11 11 D1 D1 D1 D1 D1 51 D1 CB CD 0E 01 02 03 11 11 11 11 11 11 11 11 11 11 00 E0 09 01 02 05 7B 4C 7B 4C 00 00 01 00
				39 01 00 00 05 00 02 f7 02

				39 01 00 00 00 00 24 C8 00 4B 00 1E 00 6C 5E 5F 5F 59 5B 59 3F 3F 41 44 43 45 54 51 52 4D 4B 4B 25 2B 22 B2 94 29 00 00 00 33 04
				39 01 00 00 00 00 05 c0 00 00 D8 D8
				39 01 00 00 00 00 05 2A 00 00 05 9F
				39 01 00 00 64 00 02 f7 03
				39 01 00 00 00 00 02 f7 00

				39 01 00 00 00 00 02 C7 06

				39 01 00 00 00 00 03 f1 a5 a5
				39 01 00 00 00 00 03 f0 a5 a5];
		oem,mdss-dsi-on-recovery-command-state = "dsi_lp_mode";
		oem,mdss-dsi-on-to-lpm-command = [05 01 00 00 17 00 01 28
				39 01 00 00 00 00 03 f0 5a 5a
				39 01 00 00 00 00 02 53 22
				39 01 00 00 00 00 02 B0 05
				39 01 00 00 00 00 04 BB 4D 42 5C    /* Set lowest brightness (10 nits) */
				39 01 00 00 01 00 02 f7 03
				39 01 00 00 00 00 02 f7 00
				39 01 00 00 00 00 03 f0 a5 a5
				05 01 00 00 00 00 01 29];
		oem,mdss-dsi-on-to-lpm-command-state = "dsi_hs_mode";
		oem,mdss-dsi-lpm-to-on-command = [05 01 00 00 17 00 01 28
				39 01 00 00 00 00 03 f0 5a 5a
				39 01 00 00 00 00 02 53 00
				39 01 00 00 01 00 02 f7 03
				39 01 00 00 00 00 02 f7 00
				39 01 00 00 00 00 03 f0 a5 a5
				05 01 00 00 00 00 01 29];
		oem,mdss-dsi-lpm-to-on-command-state = "dsi_hs_mode";
		oem,mdss-dsi-read-serial-command = [39 01 00 00 00 00 03 f0 5a 5a
				39 01 00 00 78 00 02 f2 63
				06 01 00 00 00 00 01 c9
				39 01 00 00 00 00 03 f0 a5 a5];
		oem,mdss-dsi-read-serial-id-bytes = [05 06 07 08 09 0a 0b 0c 0d 0e 0f 10 11];
		oem,mdss-dsi-partial-window-en-command = [39 01 00 00 00 00 05 30 00 00 00 00
				05 01 00 00 00 00 01 12];
		/* Specify byte positions in the oem,mdss-dsi-partial-window-en-command
		   where we will populate the start row and end row */
		oem,mdss-dsi-partial-window-sr-bytes = [09 08];
		oem,mdss-dsi-partial-window-er-bytes = [0b 0a];
		oem,mdss-dsi-partial-window-dis-command = [05 01 00 00 00 00 01 13];
		qcom,mdss-dsi-h-sync-pulse = <0>;
		qcom,mdss-dsi-traffic-mode = "non_burst_sync_event";
		qcom,mdss-dsi-lane-0-state;
		qcom,mdss-dsi-lane-1-state;
		qcom,mdss-dsi-lane-2-state;
		qcom,mdss-dsi-lane-3-state;
		qcom,mdss-dsi-te-pin-select = <1>;
		qcom,mdss-dsi-te-v-sync-rd-ptr-irq-line = <0x2c>;
		qcom,mdss-dsi-te-v-sync-continues-lines = <0x3c>;
		qcom,mdss-dsi-te-dcs-command = <1>;
		qcom,mdss-dsi-te-check-enable;
		qcom,mdss-dsi-te-using-te-pin;
		qcom,mdss-dsi-panel-timings = [F3 34 22 00 62 66 28 36 2B 03 04 00];
		qcom,mdss-dsi-t-clk-post = <0x03>;
		qcom,mdss-dsi-t-clk-pre = <0x25>;
		qcom,mdss-dsi-bl-pmic-control-type = "bl_ctrl_dcs";
		qcom,mdss-dsi-bl-min-level = <1>;
		qcom,mdss-dsi-bl-max-level = <255>;
		qcom,mdss-dsi-dma-trigger = "trigger_sw";
		qcom,mdss-dsi-mdp-trigger = "none";
		qcom,mdss-dsi-reset-sequence = <0 1>, <1 10>;
        /* Values provided by Display Hardware team, specific to this
         * panel used for color correction.
         * The first 4 values should be white (R,B and G=255), red (R=255,
         * G and B=0), green (G=255, R and B=0) and blue (B=255, R and
         * G=0), in that order. The x,y and Y values are measured by the
         * Display HW team and are multiplied by 10000 to covert them to
         * integers.  They are converted back to floating point when used
         * in color management calculations.
         *                                R    G    B    x       y     Y */

		oem,mdss-dsi-bbry-color-points = <255  255  255  3103    3284  3531227>,
                                         <255  0    0    6616    3377  984565>,
                                         <0    255  0    2301    7106  2341208>,
                                         <0    0    255  1430    452   205455>,
                                         <87   108  67   3262    4518  456942>,
                                         <103  189  170  2324    3607  1429543>,
                                         <133  128  177  2658    2435  841100>,
                                         <194  150  130  3941    3597  1314740>,
                                         <8    133  161  1714    2599  634335>,
                                         <231  199  31   4646    5003  2150972>,
                                         <80   91   166  2062    1710  399384>;
	};
};
