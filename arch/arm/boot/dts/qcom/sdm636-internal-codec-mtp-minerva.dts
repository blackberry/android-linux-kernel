/* Copyright (c) 2017, The Linux Foundation. All rights reserved.
 *
 * This program is free software; you can redistribute it and/or modify
 * it under the terms of the GNU General Public License version 2 and
 * only version 2 as published by the Free Software Foundation.
 *
 * This program is distributed in the hope that it will be useful,
 * but WITHOUT ANY WARRANTY; without even the implied warranty of
 * MERCHANTABILITY or FITNESS FOR A PARTICULAR PURPOSE.  See the
 * GNU General Public License for more details.
 */


/dts-v1/;

#include "sdm636.dtsi"
#include "sdm636-mtp.dtsi"
#include "sdm660-internal-codec.dtsi"
#include "sdm636-bbry-minerva.dtsi" // MODIFIED by hongwei.tian, 2017-08-25,BUG-5156882

/ {
	model = "Qualcomm Technologies, Inc. SDM 636 PM660 + PM660L Int. Audio Codec MTP";
	compatible = "qcom,sdm636-mtp", "qcom,sdm636", "qcom,mtp";
	qcom,board-id = <0xBA000008 0>; // MODIFIED by hongwei.tian, 2018-05-28,BUG-6340067
	qcom,pmic-id = <0x0001001b 0x0101011a 0x0 0x0>,
			<0x0001001b 0x0201011a 0x0 0x0>;
};

&int_codec {
	qcom,model = "sdm660-snd-card-bbj100"; // MODIFIED by hongwei.tian, 2017-09-20,BUG-5354201
	status = "okay";
};
