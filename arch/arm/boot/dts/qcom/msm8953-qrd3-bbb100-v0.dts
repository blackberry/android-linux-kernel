/* Copyright (C) 2016 BlackBerry Limited. All rights reserved.
 * Copyright (c) 2015-2016, The Linux Foundation. All rights reserved.
 *
 * This program is free software; you can redistribute it and/or modify
 * it under the terms of the GNU General Public License version 2 and
 * only version 2 as published by the Free Software Foundation.
 *
 * This program is distributed in the hope that it will be useful,
 * but WITHOUT ANY WARRANTY; without even the implied warranty of
 * MERCHANTABILITY or FITNESS FOR A PARTICULAR PURPOSE.  See the
 * GNU General Public License for more details.
 */

/dts-v1/;

#include "msm8953.dtsi"
#include "msm-pmi8950.dtsi"
#include "msm8953-pmi8950.dtsi"
#include "msm8953-qrd-sku3.dtsi"
#include "msm8953-qrd3-bbb100-v0.dtsi"

/ {
	model = "MSM 8953 BBB100PROTOQRD3 V0";
	compatible = "qcom,msm8953-qrd-sku3",
		   "qcom,msm8953-qrd", "qcom,msm8953", "qcom,qrd";

	qcom,board-id= <0xF2409867 0x00010100>; /* R--- Special proto (bbb100protoqrd3) for qrd-sku3 device */

	hwfeatures {
		mechanical {
			rev = "M0";
		};
	};

};

