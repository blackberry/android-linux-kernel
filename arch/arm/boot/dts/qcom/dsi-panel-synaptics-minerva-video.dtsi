/* Copyright (c) 2015, The Linux Foundation. All rights reserved.
 *
 * This program is free software; you can redistribute it and/or modify
 * it under the terms of the GNU General Public License version 2 and
 * only version 2 as published by the Free Software Foundation.
 *
 * This program is distributed in the hope that it will be useful,
 * but WITHOUT ANY WARRANTY; without even the implied warranty of
 * MERCHANTABILITY or FITNESS FOR A PARTICULAR PURPOSE.  See the
 * GNU General Public License for more details.
 */

/*---------------------------------------------------------------------------
 * This file is autogenerated file using gcdb parser. Please do not edit it.
 * Update input XML file to add a new entry or update variable in this file
 * VERSION = "1.0"
 *---------------------------------------------------------------------------*/
&mdss_mdp {
	dsi_synaptics_video: qcom,mdss_dsi_synaptics_minerva_video {
		qcom,mdss-dsi-panel-name = "Synaptics minerva video mode dsi panel";
		qcom,mdss-dsi-panel-type = "dsi_video_mode";
		qcom,mdss-dsi-panel-framerate = <60>;
		qcom,mdss-dsi-virtual-channel-id = <0>;
		qcom,mdss-dsi-stream = <0>;
		qcom,mdss-dsi-panel-width = <1080>;
		qcom,mdss-dsi-panel-height = <2160>;
		qcom,mdss-pan-physical-width-dimension = <63>;  /* 435 px/inch = (1080 px / 63mm) * 25.4 mm/inch  */
		qcom,mdss-pan-physical-height-dimension = <95>; /* 435 px/inch = (1620 px / 95mm) * 25.4 mm/inch  */
		qcom,mdss-dsi-h-front-porch = <70>;
		qcom,mdss-dsi-h-back-porch = <16>;
		qcom,mdss-dsi-h-pulse-width = <4>;
		qcom,mdss-dsi-h-sync-skew = <0>;
		qcom,mdss-dsi-v-back-porch = <33>;
		qcom,mdss-dsi-v-front-porch = <4>;
		qcom,mdss-dsi-v-pulse-width = <2>;
		qcom,mdss-dsi-h-left-border = <0>;
		qcom,mdss-dsi-h-right-border = <0>;
		qcom,mdss-dsi-v-top-border = <0>;
		qcom,mdss-dsi-v-bottom-border = <0>;
		qcom,mdss-dsi-bpp = <24>;
		qcom,mdss-dsi-underflow-color = <0xff>;
		qcom,mdss-dsi-border-color = <0>;
		qcom,mdss-dsi-on-command = [
            29 01 00 00 00 00 02 B0 00
            29 01 00 00 00 00 04 B3 31 00 06
            29 01 00 00 00 00 02 B4 00
            29 01 00 00 00 00 06 B6 33 5B 81 12 00
            29 01 00 00 00 00 08 B8 57 3D 19 1E 0A 50 50
            29 01 00 00 00 00 08 B9 6F 3D 28 3C 14 C8 C8
            29 01 00 00 00 00 08 BA B5 33 41 64 23 A0 A0
            29 01 00 00 00 00 03 BB 14 14
            29 01 00 00 00 00 03 BC 37 32
            29 01 00 00 00 00 03 BD 64 32
            29 01 00 00 00 00 02 BE 04
            29 01 00 00 00 00 02 C0 00
            29 01 00 00 00 00 31 C1 04 40 00 FF FF C0 9A 2B E3 BF FF FF 97 11 C2 28 FF FF FF 7D 41 5C 63 E0 FF 0F 00 00 00 00 00 00 00 00 40 02 62 11 06 02 02 00 01 00 01 00 00 00
            29 01 00 00 00 00 19 C2 01 F8 70 08 64 04 0C 10 00 08 30 00 00 00 00 00 00 00 00 08 00 00 00 00
            29 01 00 00 00 00 3f C3 86 58 65 86 50 00 00 00 00 00 41 B4 1B 00 00 46 14 61 00 00 01 01 03 28 00 01 00 01 00 00 15 00 15 00 2C 01 00 00 00 00 00 00 00 00 00 00 00 00 28 00 28 00 5A 02 00 00 00 00 00 00 08 08
            29 01 00 00 00 00 15 C4 70 00 00 00 00 00 00 00 00 02 02 31 01 00 00 00 02 01 01 01
            29 01 00 00 00 00 09 C5 08 00 00 00 00 70 00 00
            29 01 00 00 00 00 40 C6 44 00 44 03 3D 01 0E 01 02 01 02 01 02 00 00 00 00 07 0E 04 44 00 47 54 00 00 00 00 00 00 00 00 00 00 00 00 00 00 00 00 00 00 00 00 00 00 00 00 00 00 00 00 00 00 00 00 00 00 00 00 00 00 00
            29 01 00 00 00 00 27 C7 06 1C 2A 3E 4D 59 71 82 8F 9B 4D 5A 68 7C 85 90 9D A8 B2 06 1B 29 3D 4C 58 70 81 8F 9B 4D 5A 68 7C 85 90 9D A8 B2
            29 01 00 00 00 00 38 C8 00 00 00 00 00 FC 00 00 00 00 00 FC 00 00 00 00 00 FC 00 00 00 00 00 FC 00 00 00 00 00 FC 00 00 00 00 00 FC 00 00 00 00 00 FC 00 00 00 00 00 FC 00 00 00 00 00 FC 00
            29 01 00 00 00 00 14 C9 00 00 00 00 00 FC 00 00 00 00 00 FC 00 00 00 00 00 FC 00
            29 01 00 00 00 00 2c CA 1C FC FC FC 00 00 00 00 00 00 00 00 00 00 00 00 00 00 00 00 00 00 00 00 00 00 00 00 00 00 00 00 00 00 00 00 00 00 00 00 00 00 00
            29 01 00 00 00 00 1c CB F8 85 1F FA 0D 40 00 00 20 00 11 50 00 0D 00 00 00 00 00 00 00 00 00 00 00 00 00
            29 01 00 00 00 00 03 CC 37 00
            29 01 00 00 00 00 27 CD 1D 00 23 00 23 00 5C 02 BF BF E3 E3 AF AF E2 E2 01 00 00 00 00 00 00 00 00 00 00 00 00 00 00 00 00 00 00 00 00 A2
            29 01 00 00 00 00 1a CE 5D 40 49 53 59 5E 63 68 6E 74 7E 8A 98 A8 BB D0 FF 04 00 04 04 42 00 69 5A
            29 01 00 00 00 00 03 CF 48 1D
            29 01 00 00 00 00 14 D0 33 59 CF 31 01 10 10 10 19 19 00 00 00 00 00 00 00 6D 65
            29 01 00 00 00 00 02 D1 00
            29 01 00 00 00 00 16 D3 1B 3B BB 77 77 77 BB B3 33 00 00 6E 60 E7 E7 33 BB F2 FD C6 0B
            29 01 00 00 00 00 0b D5 03 00 00 02 00 02 00 01 00 00
            29 01 00 00 00 00 02 D6 C1
            29 01 00 00 00 00 22 D7 86 FF 03 05 41 24 80 1F C7 1F 1B 00 0C 07 20 00 00 00 00 00 0C F0 07 00 0C 00 00 AA 67 7E 1D 06 00
            29 01 00 00 00 00 08 D9 00 30 14 3E 05 77 02
            29 01 00 00 00 00 05 DD 30 06 23 65
            29 01 00 00 00 00 05 DE 00 3F FF 90
            29 01 00 00 00 00 02 EA 9F
            29 01 00 00 00 00 04 EE 41 51 00
            29 01 00 00 00 00 04 F1 00 00 00
            29 01 00 00 00 00 02 B0 03
            39 01 00 00 00 00 02 51 ff
            39 01 00 00 00 00 02 53 2c
            39 01 00 00 64 00 02 55 00
            05 01 00 00 cb 00 02 11 00
            05 01 00 00 14 00 02 29 00
			];
		qcom,mdss-dsi-off-command = [
			05 01 00 00 22 00 02 28 00
			05 01 00 00 78 00 02 10 00
			];
		qcom,mdss-dsi-on-command-state = "dsi_lp_mode";
		qcom,mdss-dsi-off-command-state = "dsi_hs_mode";
		qcom,mdss-dsi-h-sync-pulse = <1>;
		qcom,mdss-dsi-traffic-mode = "burst_mode";
		qcom,mdss-dsi-bllp-eof-power-mode;
		qcom,mdss-dsi-bllp-power-mode;
		qcom,mdss-dsi-lane-0-state;
		qcom,mdss-dsi-lane-1-state;
		qcom,mdss-dsi-lane-2-state;
		qcom,mdss-dsi-lane-3-state;
		qcom,mdss-dsi-panel-timings-phy-v2 = [24 1f 08 09 05 03 04 a0
			24 1f 08 09 05 03 04 a0
			24 1f 08 09 05 03 04 a0
			24 1f 08 09 05 03 04 a0
			24 1c 08 09 05 03 04 a0];
		qcom,mdss-dsi-t-clk-post = <0x20>;
		qcom,mdss-dsi-t-clk-pre = <0x34>;
		qcom,mdss-dsi-bl-min-level = <1>;
		qcom,mdss-dsi-bl-max-level = <4095>;
		qcom,mdss-dsi-dma-trigger = "trigger_sw";
		qcom,mdss-dsi-mdp-trigger = "none";
		qcom,mdss-dsi-bl-pmic-control-type = "bl_ctrl_wled";
		qcom,mdss-dsi-reset-sequence = <1 20>, <0 2>, <1 20>;
		//qcom,esd-check-enabled;
		qcom,mdss-dsi-panel-status-command = [06 01 00 01 05 00 02 0A 08];
		qcom,mdss-dsi-panel-status-command-mode = "dsi_lp_mode";
		qcom,mdss-dsi-panel-status-check-mode = "reg_read";
		qcom,mdss-dsi-panel-status-read-length = <1>;
		qcom,mdss-dsi-panel-status-value = <0x1C>;
		qcom,mdss-dsi-panel-max-error-count = <3>;
	};
};
