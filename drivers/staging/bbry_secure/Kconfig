## drivers/staging/bbry_secure/Kconfig
```kconfig
#start: BBSECURE_BUILD

# Copyright (C) 2018 BlackBerry Limited
#
# This software is licensed under the terms of the GNU General Public
# License version 2, as published by the Free Software Foundation, and
# may be copied, distributed, and modified under those terms.
#
# This program is distributed in the hope that it will be useful,
# but WITHOUT ANY WARRANTY; without even the implied warranty of
# MERCHANTABILITY or FITNESS FOR A PARTICULAR PURPOSE.  See the
# GNU General Public License for more details.
#
# Note:
# This Kconfig is the entry point for blackberry feature configurations.
# Each config should follow the BBSECURE_<FEATURE_NAME> convention.
# For details please refer to blackberry tagging guideline.

menu "Blackberry feature selection"

config BBSECURE_LSM_TEST_SUPPORT
	bool "Blackberry LSM test support"
	default n
	help
	  Say 'Y' if you would like to support the LSM tests of Blackberry,
	  'N' otherwise.

config BBSECURE_MMAP_MIN_ADDR_WRITABLE
	bool "Make /proc/sys/vm/mmap_min_addr read-only"
	depends on MMU
	default n
	help
	  Makes the /proc/sys/vm/mmap_min_addr writable. Defaults to N.

config BBSECURE_UEVENT_HELPER_WRITABLE
	bool "Make uevent_helper writable"
	depends on UEVENT_HELPER
	default n
	help
	  Makes /proc/sys/kernel/hotplug and /sys/kernel/uevent_helper
	  writable. Defaults to N.

config BBSECURE_CORE_PATTERN_DEFAULT
	string "Default core pattern"
	depends on COREDUMP
	default "core"
	help
	  Default value for /proc/sys/kernel/core_pattern.

config BBSECURE_CORE_PATTERN_WRITABLE
	bool "Makes core_pattern writable"
	depends on COREDUMP
	default n
	help
	  Makes /proc/sys/kernel/core_pattern writable. Defaults to N.

config BBSECURE_MODULE_MODPROBE_DEFAULT
	string "Module modprobe default command"
	depends on MODULES
	default ""
	help
	  Modprobe default command to be executed on kernel module request.
	  Defaults to empty.

config BBSECURE_MODULE_MODPROBE_WRITABLE
	bool "Makes /proc/sys/kernel/modprobe writable"
	depends on MODULES
	default n
	help
	  Enables writing to /proc/sys/kernel/modprobe. Defaults to N.

config BBSECURE_POWEROFF_CMD_DEFAULT
	string "Default poweroff_cmd to execute"
	default ""
	help
	  Default command string to execute for poweroff_cmd. Defaults to empty.

config BBSECURE_POWEROFF_CMD_WRITABLE
	bool "Make /proc/sys/kernel/poweroff_cmd writable"
	default n
	depends on POWEROFF_CMD
	help
	  Makes /proc/sys/kernel/poweroff_cmd writable. Defaults to N.

config BBSECURE_HEAP_RAND_PROCFS_WRITABLE
	bool "Make /proc/sys/kernel/randomize_va_space writable"
	depends on MMU
	default n
	help
	  Makes the /proc/sys/kernel/randomize_va_space writable. Defaults to N.

config BBSECURE_O_BENEATH
	bool "Limits files to be opened must be at or under the direcotry where open is invoked"
	default y
	help
	  Say 'Y' if you would like to limit files to be opened must be
	  at or under the direcotry where open is invoked. 'N' otherwise.

config BBSECURE_O_NOSYMLINK
	bool "Disallow symlinks in the path of the file to be opened"
	default y
	help
	  Say 'Y' if you would like to disallow symlinks in the path of the files
	  to be opened. 'N' otherwise.

config BBSECURE_VENDOR
	bool "Pull in Blackberry specific kernel modules outside of kernel source tree"
	default y
	help
	  Say 'Y' if you need Blackberry specific kernel modules outside of kernel
	  source tree. 'N' otherwise.

#start: BBSECURE_PROTECTED_VARS
config DOES_NOT_RUN
	bool
	---help---
	 This option is selected by other debugging kernel configuration options
	 that would cause the built kernel to be non-bootable.  In particular,
	 it is used by build options designed to verify source

config BBSECURE_PROTECTED_VARS
	bool "Move critical kernel variables to read-only memory"
	default y
	help
	  This option moves certain kernel variables into read-only memory,
	  enforcing that updates to the variables be arbitrated.  It is
	  designed to resist accidental or malicious modifications to
	  highly-sensitive kernel variables.

	  If unsure, say N

config BBSECURE_PROTECTED_VARS_CONST
	bool "Define protected variables as const"
	depends on DEBUG_KERNEL
	depends on BBSECURE_PROTECTED_VARS
	select DOES_NOT_RUN
	---help---
	  This declares all proteced variables as const to catch assignments at
	  the compile phase.  Note that because the compiler may optimize const
	  variables differently by assuming they never change, this setting will
	  also enable the DOES_NOT_RUN kernel configuration setting, preventing
	  the creation of bootable kernel images.

	  If unsure, say N
#end: BBSECURE_PROTECTED_VARS

config BBSECURE_SECURITY_SELINUX_DEVELOP_ENFORCE
	bool "NSA SELinux Development Support via debug token"
	depends on SECURITY_SELINUX
	default n
	help
	  This option allows the selinux enforce=0|1 on the kernel
	  command line to remain active so that the device can be booted
	  in permissive mode if a debug token exists. The mode cannot
	  be toggled at runtime. With this option enabled the kernel
	  will start in enforcing mode unless you specify enforcing=0 on
	  the kernel command line

config BBSECURE_SECURITY_SELINUX_AVD_PERMISSIVE
	bool "NSA SELinux AVD Permissive Support"
	depends on SECURITY_SELINUX
	default n
	help
	  This enables the support for the AVD_FLAGS_PERMISSIVE
	  flag. If set to no, then local policy permissibility will
	  not be allowed.

config BBSECURE_SDBASE
	bool "BlackBerry Base SDCardFS Support"
	depends on SDCARD_FS
	default y
	help
	  Sdcardfs support for basic BlackBerry features to meet Google's CDD
	  requirements.

config BBSECURE_SDAFW
	bool "BlackBerry Android for Work support for SDCardFS"
	depends on SDCARD_FS && BBSECURE_SDBASE
	default y
	help
	  Android for Work support for removable devices including SD cards and
	  USB OTG.

source security/pathtrust/Kconfig

config BBSECURE_BIDE
	bool "BlackBerry Integrity Detection support"
	default y
	help
	  Say 'Y' if you would like to support BlackBerry Integrity Detection,
	  'N' otherwise.

config BBSECURE_ADBAFW
	bool "BlackBerry Android for Work support for ADB"
	depends on SDCARD_FS && BBSECURE_SDBASE
	default y
	help
	  Android for Work support for ADB.

endmenu

#end: BBSECURE_BUILD
```

## drivers/staging/wifi/Kconfig
```kconfig
config MSM_BCM_PCIE
	bool "Add board support file for QC MSM and Broadcom Wifi PCIe"
	depends on BBRY && PCI_MSM && BCMDHD && BCMDHD_PCIE
	default n
	---help---
	help
	  If unsure, say N.
```

## drivers/usb/pd/Kconfig
```kconfig
#
# USB Power Delivery driver configuration
#
menu "USB Power Delivery"

config USB_PD
	def_bool n

config USB_PD_POLICY
	tristate "USB Power Delivery Protocol and Policy Engine"
	depends on EXTCON
	depends on DUAL_ROLE_USB_INTF
	select USB_PD
	help
          Say Y here to enable USB PD protocol and policy engine.

config QPNP_USB_PDPHY
	tristate "QPNP USB Power Delivery PHY"
	depends on SPMI
	help
          Say Y here to enable QPNP USB PD PHY peripheral driver
	  which communicates over the SPMI bus. The is used to handle
	  the PHY layer communication of the Power Delivery stack.

# Jin.wang added here to enable different usbpd logs level
config USB_PD_LOG_LVL
	int "USBPD Log level(0,3)"
	range 0 3
	default 1
	help
          enable different log level for usbpd debug. 0 for no logs,
          1 for error logs only, 2 for debug logs only(no error log),
          3 for all logs.
# Jin.wang added done.

endmenu
```

## drivers/video/msm/Anx_Ohio_Drv/Kconfig
```kconfig
config ANALOGIX_OHIO
	tristate "Analogix Type-C interface support"
	help
		Analogix type-c interface is a  chip support USB PD protocol device
```

## fs/sdcardfs/Kconfig
```kconfig
config SDCARD_FS
	tristate "sdcard file system"
	depends on CONFIGFS_FS
	default n
	help
	  Sdcardfs is based on Wrapfs file system.

config SDCARD_FS_FADV_NOACTIVE
	bool "sdcardfs fadvise noactive support"
	depends on FADV_NOACTIVE
	default y
	help
	  Sdcardfs supports fadvise noactive mode.

config SDCARD_FS_LOCKER
	bool "sdcardfs locker folder support"
	depends on SDCARD_FS
	default n
	help
	  Sdcardfs supports locker folder.

config SDCARD_FS_LOCKER_NAME
	string "sdcardfs locker folder name"
	depends on SDCARD_FS_LOCKER
	default "Locker"
	help
	  Sdcardfs locker folder name.
```

## security/pathtrust/Kconfig
```kconfig
config SECURITY_PATHTRUST
	bool "Pathtrust Support"
	select GLOB
	depends on SECURITY
	default n
	help
	  This select the pathtrust security module which enables mount
	  points to be whitelisted as trusted and enforces limitations on
	  what can be executed/loaded by the kernel.
	  The state of pathtrust can be read from /sys/kernel/security/pathtrust/enabled
	  where the states are enabled(1) and disabled(0) (requires SECURITYFS enabled and
	  mounted). If you are unsure how to answer this question, answer N.

config SECURITY_PATHTRUST_ROOTFS
	bool "Pathtrust whitelist rootfs"
	depends on SECURITY_PATHTRUST
	default y
	help
	  This whitelists rootfs in pathtrust at module init time. It also
	  sets the rootfs mount as 'trusted' at kernel init time.
	  Defaults to Y.

config SECURITY_PATHTRUST_WHITELIST_IMPLICIT
	bool "Consider all devices implicitly whitelisted"
	depends on SECURITY_PATHTRUST
	default n
	help
	  Considers all devices whitelisted for debugging
	  purposes on systems where devices may not be whitelisted
	  using the normal process. Defaults to n.

config SECURITY_PATHTRUST_PATHNAMES
	string "Whitelisted pathnames"
	depends on SECURITY_PATHTRUST
	default ""
	help
	  Semi-colon separated whitelist of glob-aware pathnames to match in exec mmap
	  security checks. Full pathnames are matched. Defaults to empty.

config SECURITY_PATHTRUST_FIRMWARE
	bool "Block firmware loading from anonymous sources"
	depends on SECURITY_PATHTRUST
	default y
	help
	  Semi-colon separated whitelist of glob-aware pathnames to match in exec mmap
	  security checks. Full pathnames are matched. Defaults to Y.

config SECURITY_PATHTRUST_BOOTPARAM
	bool "Pathtrust boot parameter"
	depends on SECURITY_PATHTRUST
	default n
	help
	  This option adds a kernel parameter 'pathtrust', which allows Pathtrust
	  to be disabled at boot.  If this option is selected, Pathtrust
	  functionality can be disabled with pathtrust=0 on the kernel
	  command line.  The purpose of this option is to allow a single
	  kernel image to be distributed with Pathtrust built in, but not
	  necessarily enabled. Defaults to N.

	  If you are unsure how to answer this question, answer N.

config SECURITY_PATHTRUST_BOOTPARAM_VALUE
	int "Pathtrust boot parameter default value"
	depends on SECURITY_PATHTRUST_BOOTPARAM
	range 0 1
	default 1
	help
	  This option sets the default value for the kernel parameter
	  'pathtrust', which allows Pathtrust to be disabled at boot.  If this
	  option is set to 0 (zero), the Pathtrust kernel parameter will
	  default to 0, disabling Pathtrust at bootup.  If this option is
	  set to 1 (one), the Pathtrust kernel parameter will default to 1,
	  enabling Pathtrust at bootup. Defaults to 1.

	  If you are unsure how to answer this question, answer 1.

config SECURITY_PATHTRUST_DEVELOP
	bool "Pathtrust Development Support"
	depends on SECURITY_PATHTRUST
	default n
	help
	  This enables the development support option of Pathtrust. This
	  enables you to toggle pathtrust between enabled (1) or disabled (0)
	  via /sys/kernel/security/pathtrust/enabled. Defaults to N.

config SECURITY_PATHTRUST_SELINUX
	bool "Pathtrust SELinux Support"
	depends on SECURITY_PATHTRUST
	default y
	help
	  This enables the selinux forbidden context support in pathtrust.
	  This feature enables one to load forbidden context domains which are
	  not allowed to execute files on untrusted filesystems. Defaults to Y.
```
