## Documentation/devicetree/bindings/leds/leds-max77387.txt
```
Binding for flash LEDs connected to Maxim MAX77387.

Maxim MAX77387 flash LED driver is used to provide camera flash and
torch capability for up to two LEDS. MAX77387 LED is connected
through I2C.

Required properties:
 - compatible		: should be compatible = "maxim,max77387"
 - reg			: 7 bit i2c slave address of the device
 - vdd-supply		: Power supply needed to power up the device
 - flash-type		: should be flash-type ="MAX77387";
 - max-current		: Maximum allowed flash current in milliamps
 - default-current	: Default flash current in milliamps

Example:

	max77387_flash@4A {
		compatible = "maxim,max77387";
		reg = <0x4A>;
		vdd-supply = "pm8994_l30";
		flash-type = "MAX77387";
		max-current = <2000>;
		default-current = <2000>;
	};
```

## arch/arm64/Kconfig.debug
```kconfig
menu "Kernel hacking"

source "lib/Kconfig.debug"

config ARM64_PTDUMP
	bool "Export kernel pagetable layout to userspace via debugfs"
	depends on DEBUG_KERNEL
	select DEBUG_FS
	depends on !GRKERNSEC_KMEM
        help
	  Say Y here if you want to show the kernel pagetable layout in a
	  debugfs file. This information is only useful for kernel developers
	  who are working in architecture specific areas of the kernel.
	  It is probably not a good idea to enable this feature in a production
	  kernel.
	  If in doubt, say "N"

config STRICT_DEVMEM
	bool "Filter access to /dev/mem"
	depends on MMU
	help
	  If this option is disabled, you allow userspace (root) access to all
	  of memory, including kernel and userspace memory. Accidental
	  access to this is obviously disastrous, but specific access can
	  be used by people debugging the kernel.

	  If this option is switched on, and IO_STRICT_DEVMEM=n, the /dev/mem
	  file only allows userspace access to PCI space and the BIOS code and
	  data regions.  This is sufficient for dosemu and X and all common
	  users of /dev/mem.

	  If in doubt, say Y.

config IO_STRICT_DEVMEM
	bool "Filter I/O access to /dev/mem"
	depends on STRICT_DEVMEM
	default STRICT_DEVMEM
	---help---
	  If this option is disabled, you allow userspace (root) access to all
	  io-memory regardless of whether a driver is actively using that
	  range.  Accidental access to this is obviously disastrous, but
	  specific access can be used by people debugging kernel drivers.
	  
	  If this option is switched on, the /dev/mem file only allows
	  userspace access to *idle* io-memory ranges (see /proc/iomem) This
	  may break traditional users of /dev/mem (dosemu, legacy X, etc...)
	  if the driver using a given range cannot be disabled.

 	  If in doubt, say Y.

config PID_IN_CONTEXTIDR
	bool "Write the current PID to the CONTEXTIDR register"
	help
	  Enabling this option causes the kernel to write the current PID to
	  the CONTEXTIDR register, at the expense of some additional
	  instructions during context switch. Say Y here only if you are
	  planning to use hardware trace tools with this kernel.

config ARM64_RANDOMIZE_TEXT_OFFSET
	bool "Randomize TEXT_OFFSET at build time"
	help
	  Say Y here if you want the image load offset (AKA TEXT_OFFSET)
	  of the kernel to be randomized at build-time. When selected,
	  this option will cause TEXT_OFFSET to be randomized upon any
	  build of the kernel, and the offset will be reflected in the
	  text_offset field of the resulting Image. This can be used to
	  fuzz-test bootloaders which respect text_offset.

	  This option is intended for bootloader and/or kernel testing
	  only. Bootloaders must make no assumptions regarding the value
	  of TEXT_OFFSET and platforms must not require a specific
	  value.

config DEBUG_WX
	bool "Warn on WX mappings at boot"
	select ARM64_PTDUMP_CORE
	---help---
	  Generate a warning if any WX mappings are found at boot.

	  This is useful for discovering cases where the kernel is leaving
	  WX mappings after applying NX, as such mappings are a security risk.
	  This check also includes UXN, which should be set on all kernel
	  mappings.

	  Look for a message in dmesg output like this:

	    arm64/mm: Checked WX mappings: passed, no WX pages found.

	  or like this, if the check failed:

	    arm64/mm: Checked WX mappings: FAILED, <N> WX pages found.

	  Note that even if the check fails, your kernel is possibly
	  still fine, as WX mappings are not a security hole in
	  themselves, what they do is that they make the exploitation
	  of other unfixed kernel bugs easier.

	  There is no runtime or memory usage effect of this option
	  once the kernel has booted up - it's a one time check.

	  If in doubt, say "Y"

config DEBUG_SET_MODULE_RONX
        bool "Set loadable kernel module data as NX and text as RO"
        depends on MODULES
        help
          This option helps catch unintended modifications to loadable
          kernel module's text and read-only data. It also prevents execution
          of module data. Such protection may interfere with run-time code
          patching and dynamic kernel tracing - and they might also protect
          against certain classes of kernel exploits.
          If in doubt, say "N".

config DEBUG_RODATA
	bool "Make kernel text and rodata read-only"
	default y
	help
	  If this is set, kernel text and rodata will be made read-only. This
	  is to help catch accidental or malicious attempts to change the
	  kernel's executable code.

	  If in doubt, say Y

config DEBUG_ALIGN_RODATA
	depends on DEBUG_RODATA
	bool "Align linker sections up to SECTION_SIZE"
	help
	  If this option is enabled, sections that may potentially be marked as
	  read only or non-executable will be aligned up to the section size of
	  the kernel. This prevents sections from being split into pages and
	  avoids a potential TLB penalty. The downside is an increase in
	  alignment and potentially wasted space. Turn on this option if
	  performance is more important than memory pressure.

	  If in doubt, say N

config FORCE_PAGES
        bool "Force lowmem to be mapped with 4K pages"
        help
          There are some advanced debug features that can only be done when
          memory is mapped with pages instead of sections. Enable this option
          to always map lowmem pages with pages. This may have a performance
          cost due to increased TLB pressure.

          If unsure say N.

config FREE_PAGES_RDONLY
        bool "Set pages as read only while on the buddy list"
        select FORCE_PAGES
        select DEBUG_PAGEALLOC
        help
          Pages are always mapped in the kernel. This means that anyone
          can write to the page if they have the address. Enable this option
          to mark pages as read only to trigger a fault if any code attempts
          to write to a page on the buddy list. This may have a performance
          impact.

          If unsure, say N.

config KERNEL_TEXT_RDONLY
        bool "Set kernel text section pages as read only"
	depends on FREE_PAGES_RDONLY
        depends on !DEBUG_RODATA
        help
          The kernel text pages are always mapped in the kernel.
	  This means that anyone can write to the page if they have
	  the address. Enable this option to mark the kernel text pages
	  as read only to trigger a fault if any code attempts to write
	  to a page part of the kernel text section. This may have a
	  performance impact.

          If unsure, say N.

config ARM64_STRICT_BREAK_BEFORE_MAKE
	bool "Enforce strict break-before-make on page table updates "

source "drivers/hwtracing/coresight/Kconfig"

endmenu
```

## arch/arm64/Kconfig.products
```kconfig
menu "Products selection"
config TCT_SDM660_COMMON
	bool "SDM660 TCT COMMON CONFIG"
	depends on ARCH_SDM660
	help
	  Support for TCT common device configration.

config TCT_SDM660_ATHENA
	bool "SDM660 TCT ATHENA"
	depends on ARCH_SDM660
	help
	  Support for TCT ATHENA device.

config TCT_SDM636_LUNA
	bool "SDM636 TCT LUNA"
	depends on ARCH_SDM660
	help
	  Support for TCT LUNA device.

config TCT_SDM636_MINERVA
	bool "SDM636 TCT MINERVA"
	depends on ARCH_SDM660
	help
	  Support for TCT LUNA device.

endmenu
```

## drivers/bide/Kconfig
```kconfig
config BBRY_BIDE
	tristate "BlackBerry Intrusion Detection Engine Driver"
	depends on BBRY && SECURITY
	default n
	help
	  This is the BlackBerry Intrusion Deteciton Engine.
	  This should be part of AOSP. If unsure, say N.
```

## drivers/bluetooth/broadcom/Kconfig
```kconfig
menu "Broadcom Bluetooth device drivers"
	depends on BT

config BCM_BLUESLEEP
	tristate "Broadcom MSM Bluesleep driver"
	depends on BT && SERIAL_MSM_HS
	default n
	help
	  Bluetooth Broadcom MSM bluesleep driver.
	  This driver provides support for Broadcom sleep.

config BCM_BT_RFKILL
	tristate "Broadcom RFKILL driver"
	depends on BT && SERIAL_MSM_HS && BCM_BLUESLEEP
	default n
	help
	  Bluetooth Broadcom RFKILL/enable driver.
	  This driver provides support for disabling Broadcom Bluetooth
          functionlity.

endmenu
```

## drivers/fingerprint/Kconfig
```kconfig
config FINGERPRINT
	tristate "fingerprint drvier support"
	help
	  Say Y here to enable fingerprint driver support!  

config FINGERPRINT_GOODIX_GF5216
	depends on FINGERPRINT
	tristate "Goodix GF3266 fingerprint drvier support"
	help
	  Say Y here to enable goodix fingerprint driver support!  
```

## drivers/input/fingerprint/fpc1020/Kconfig
```kconfig
#
# Finger print driver configuration
#
config INPUT_FPC1020
	tristate "FPC1020 finger print sensor support"
#	depends on BBRY && SPI_QUP=y
	default n
	help
	  If you say yes here you get support for FPC1020 finger print sensor.
```

## drivers/input/goodixfp3206/Kconfig
```kconfig
config GOODIX_FINGERPRINT_GF3206
	tristate "generic goodix fingerprint driver"
	default y
	help
	add support for goodix fingerprint driver.
```

## drivers/input/misc/bbry/Kconfig
```kconfig
#
# Input misc drivers configuration
#
config STM_LSM303D
	tristate "STM LSM303D acceleration and compass sensor support"
	depends on BBRY && I2C=y
	default y
	help
	  If you say yes here you get support for STMicroelectronics's
	  acceleration sensors LSM303D.

config STM_L3GD20
	tristate "STM L3GD20 gyro sensor support"
	depends on BBRY && I2C=y
	default y
	help
	  If you say yes here you get support for STMicroelectronics's
	  gyro sensors L3GD20.

config STMVL6180
	tristate "STM VL6180 Proximity support"
	depends on BBRY && I2C=y
	default y
	help
	  Say Y here if you want to use STMicroelectronics's proximity sensor
	  through I2C interface.

	  To compile this driver as a module, choose M here: the
	  module will be called stmvl6180.

config SENSOR_HUB
	tristate "Sensor hub passthrough support"
	depends on BBRY && I2C=y
	default y
	help
	  Say Y here if you want to use the sensor hub i2c passthrough
	  interface

	  To compile this driver as a module, choose M here: the
	  module will be called sensor_hub

config M4_HUB
	tristate "M4 hub support"
	depends on BBRY && I2C=y
	default y
	help
	  Say Y here if you want to use the m4 hub interface

	  To compile this driver as a module, choose M here: the
	  module will be called m4_hub

config SENSOR_EXTENDED
	tristate "Extended sensor class support"
	depends on BBRY
	default y
	help
	  Say Y here if you want to use the extended sensor class interface

	  To compile this driver as a module, choose M here: the
	  module will be called sensor_extended

config HALL_SENSOR
	tristate "Hall sensor (holster & slider) support"
	depends on BBRY
	default n
	help
	  Say Y here if you want to use the hall

	  To compile this driver as a module, choose M here: the
	  module will be called hall
```

## drivers/input/sunwavefp/Kconfig
```kconfig
config SUNWAVE_FINGERPRINT
       tristate "Sunwave Fingerprint"
       default n
       help
          SUNWAVECORP Fingerprint
```

## drivers/input/touchscreen/focaltech_bbry/Kconfig
```kconfig
#
# Focaltech touch driver configuration
#
#
# STMicroelectronics TOUCH driver configuration
#
config TOUCHSCREEN_FOCALTECH_ALL
		bool "FOCAL based touchscreen"
		depends on I2C
		help
			Say Y here if you have a touchscreen interface using the 
			FOCAL controller, and your board-specific
			setup cod includes that in its table of i2c devices.

config TOUCHSCREEN_FOCALTECH_TDDI
		bool "FOCAL based touchscreen"
		depends on I2C
		help
			Say Y here if you have a touchscreen interface using the 
			FOCAL controller, and your board-specific
			setup cod includes that in its table of i2c devices.
```

## drivers/input/touchscreen/focaltech_bbry_old/Kconfig
```kconfig
#
# STMicroelectronics TOUCH driver configuration
#

config TOUCHSCREEN_FOCALTECH_TDDI
		bool "FOCAL based touchscreen"
		depends on I2C
		help
			Say Y here if you have a touchscreen interface using the 
			FOCAL controller, and your board-specific
			setup cod includes that in its table of i2c devices.

config KEY_LED_POWER_DISABLE
      bool "KEY LED POWER DISABLE"
      help
              Say Y if you want to disable LED key button.
              Usually you might want to set it N.
```

## drivers/input/touchscreen/ft5436_idol455/Kconfig
```kconfig
config TOUCHSCREEN_FT5436_IDOL455
       tristate "FT5436 touchscreens"
       depends on I2C
       help
         Say Y here if you have a FT touchscreen on TCL 
         If unsure, say N.
         To compile this driver as a module, choose M here: the
         module will be called FT.
```

## drivers/input/touchscreen/ftm3bd54c_idol4s+idol4s_vdf/Kconfig
```kconfig
config TOUCHSCREEN_FTM3BD54C_IDOL4S
       tristate "FTM touchscreens"
       depends on I2C
       help
         Say Y here if you have a FT touchscreen on TCL 
         If unsure, say N.
         To compile this driver as a module, choose M here: the
         module will be called FT.
```

## drivers/input/touchscreen/gt5688_idol4/Kconfig
```kconfig
config TOUCHSCREEN_GT5688_IDOL4
       tristate "GT1xx touchscreens"
       depends on I2C
       help
         Say Y here if you have a FT touchscreen on TCL 
         If unsure, say N.
         To compile this driver as a module, choose M here: the
         module will be called FT.
```
