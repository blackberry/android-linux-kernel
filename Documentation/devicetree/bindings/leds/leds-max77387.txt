## drivers/input/touchscreen/s3508_idol4/Kconfig
```kconfig
#
# Synaptics DSX touchscreen driver configurationCONFIG_TOUCHSCREEN_S
#
menuconfig TOUCHSCREEN_SYNAPTICS_DSX_IDOL4
	bool "Synaptics DSX touchscreen"
	default n
	help
	  Say Y here if you have a Synaptics DSX touchscreen connected
	  to your system.

	  If unsure, say N.

if TOUCHSCREEN_SYNAPTICS_DSX_IDOL4

choice
	default TOUCHSCREEN_SYNAPTICS_DSX_I2C_IDOL4
	prompt "Synaptics DSX bus interface"
config TOUCHSCREEN_SYNAPTICS_DSX_I2C_IDOL4
	bool "RMI over I2C"
	depends on I2C
config TOUCHSCREEN_SYNAPTICS_DSX_SPI_IDOL4
	bool "RMI over SPI"
	depends on SPI_MASTER
config TOUCHSCREEN_SYNAPTICS_DSX_RMI_HID_I2C_IDOL4
	bool "HID over I2C"
	depends on I2C
endchoice

config TOUCHSCREEN_SYNAPTICS_DSX_CORE_IDOL4
	tristate "Synaptics DSX core driver module"
	depends on I2C || SPI_MASTER
	help
	  Say Y here to enable basic touch reporting functionalities.

	  If unsure, say N.

	  To compile this driver as a module, choose M here: the
	  module will be called synaptics_dsx_core.

config TOUCHSCREEN_SYNAPTICS_DSX_RMI_DEV_IDOL4
	tristate "Synaptics DSX RMI device module"
	depends on TOUCHSCREEN_SYNAPTICS_DSX_CORE_IDOL4
	help
	  Say Y here to enable support for direct RMI register access.

	  If unsure, say N.

	  To compile this driver as a module, choose M here: the
	  module will be called synaptics_dsx_rmi_dev.

config TOUCHSCREEN_SYNAPTICS_DSX_FW_UPDATE_IDOL4
	tristate "Synaptics DSX firmware update module"
	depends on TOUCHSCREEN_SYNAPTICS_DSX_CORE_IDOL4
	help
	  Say Y here to enable support for doing firmware update.

	  If unsure, say N.

	  To compile this driver as a module, choose M here: the
	  module will be called synaptics_dsx_fw_update.

config TOUCHSCREEN_SYNAPTICS_DSX_ACTIVE_PEN_IDOL4
	tristate "Synaptics DSX active pen module"
	depends on TOUCHSCREEN_SYNAPTICS_DSX_CORE_IDOL4
	help
	  Say Y here to enable support for active pen functionalities.

	  If unsure, say N.

	  To compile this driver as a module, choose M here: the
	  module will be called synaptics_dsx_active_pen.

config TOUCHSCREEN_SYNAPTICS_DSX_PROXIMITY_IDOL4
	tristate "Synaptics DSX proximity module"
	depends on TOUCHSCREEN_SYNAPTICS_DSX_CORE_IDOL4
	help
	  Say Y here to enable support for proximity functionalities.

	  If unsure, say N.

	  To compile this driver as a module, choose M here: the
	  module will be called synaptics_dsx_proximity.

config TOUCHSCREEN_SYNAPTICS_DSX_TEST_REPORTING_IDOL4
	tristate "Synaptics DSX test reporting module"
	depends on TOUCHSCREEN_SYNAPTICS_DSX_CORE_IDOL4
	help
	  Say Y here to enable support for retrieving production test reports.

	  If unsure, say N.

	  To compile this driver as a module, choose M here: the
	  module will be called synaptics_dsx_test_reporting.
	  
config TOUCHSCREEN_SYNAPTICS_DSX_GESTURE_IDOL4
	tristate "Synaptics DSX user defined gesture module"
	depends on TOUCHSCREEN_SYNAPTICS_DSX_CORE_IDOL4
	help
	  Say Y here to enable support for user defined gesture functionality.

	  If unsure, say N.

	  To compile this driver as a module, choose M here: the
	  module will be called synaptics_dsx_gesture

config TOUCHSCREEN_SYNAPTICS_DSX_VIDEO_IDOL4
	tristate "Synaptics DSX video module"
	depends on TOUCHSCREEN_SYNAPTICS_DSX_CORE_IDOL4
	help
	  Say Y here to enable support for video communication functionality.

	  If unsure, say N.

	  To compile this driver as a module, choose M here: the
	  module will be called synaptics_dsx_video.

config TOUCHSCREEN_SYNAPTICS_DSX_DEBUG
	tristate "Synaptics DSX debug module"
	depends on TOUCHSCREEN_SYNAPTICS_DSX_CORE_IDOL4
	help
	  Say Y here to enable support for firmware debug functionalities.

	  If unsure, say N.

	  To compile this driver as a module, choose M here: the
	  module will be called synaptics_dsx_debug.

endif
```

## drivers/misc/vfsSpi/Kconfig
```kconfig
#
# TI's shared transport line discipline and the protocol
# drivers (BT, FM and GPS)
#

config TCT_SYNAP
	bool "SPI driver for fingerprint"
       default n
	help
       SPI driver for finger print
```

## drivers/nfc/broadcom/Kconfig
```kconfig
#
# Near Field Communication (NFC) devices
#

config NFC_BCM2079X
	bool "Broadcom 2079X NFC Controller Driver"
	depends on I2C
	select CRC_CCITT
	help
	  Broadcom 2079X Near Field Communication controller support.
```

## drivers/power/tcl-8953-chg/Kconfig
```kconfig
config QPNP_SMBCHARGER_TCL
	tristate "QPNP SMB Charger driver for TCL older platform"
	depends on SPMI || MSM_SPMI
	depends on OF_SPMI
	help
	  Say Y here to enable the dual path switch mode battery charger which
	  supports USB detection and battery charging up to 3A.
	  The driver also offers relevant information to userspace via the
	  power supply framework.
```

## drivers/slimport/ANX7808/Kconfig
```kconfig
config SLIMPORT_ANX7808
	depends on SLIMPORT
	tristate "Analogix Slimport transmitter ANX7808 support"
	help
	  Slimport Transmitter is a HD video transmitter chip
	  over micro-USB connector for smartphone device.
config SLIMPORT_FAST_CHARGE
	bool "enable fast charge from Slimport accessary"
	depends on 	SLIMPORT_ANX7808
	help
		The maximum charge current can be up to 1A via Slimport accessay,
		 if this feature is enabled.
```

## drivers/slimport/ANX7808/cec_lib/Kconfig
```kconfig
config SLIMPORT_CEC
	bool "enable CEC feature via Slimport"
	depends on 	SLIMPORT_ANX7808
	help
		Consumer Electronic Control feature is enabled.
```

## drivers/slimport/ANX7816/Kconfig
```kconfig
config SLIMPORT_COLORADO3
	depends on SLIMPORT
	tristate "Analogix Slimport transmitter COLORADO3 support"
	help
        	Slimport Transmitter is a HD video transmitter chip 
		over micro-USB connector for smartphone device.

       
```

## drivers/slimport/Kconfig
```kconfig
config SLIMPORT
	bool "Analogix Slimport Driver support"
	help
		Slimport Transmitter is a HD video transmitter chip 
		over micro-USB connector for smartphone device.


source "drivers/slimport/ANX7816/Kconfig"

source "drivers/slimport/ANX7808/Kconfig"
```

## drivers/staging/bbry/Kconfig
```kconfig
config BBRY_HWFEATURES
	bool "Add sysfs entry from device tree hwfeature attribute"
	depends on BBRY
	default n
	---help---
	help
	  If unsure, say N.

config BBRY_PERSIST_RESET_V2
	bool "Persist memory region for reset logs - version 2"
	select PSTORE
	select PSTORE_RAM
	select PSTORE_CONSOLE
	depends on BBRY
	default n
	---help---
	help
	  If unsure, say N.

config BBRY_MFG
	bool "For code only required on manufacturing image"
	depends on BBRY
	default n
	---help---
	help
	  If unsure, say N.

config BBRY_DEBUG
	bool "For code only required on debug images (eng and userdebug for now) "
	depends on BBRY
	default n
	---help---
	help
	  If unsure, say N.

config BBRY_BSI
	bool "Export BSI binary blob to sysfs (primarily for mfg) "
	depends on BBRY
	default n
	---help---
	help
	  If unsure, say N.

config BBRY_DDT
	bool "Compile DDT feature in the kernel"
	depends on BBRY
	default n
	---help---
	help
	  If unsure, say N.
```
